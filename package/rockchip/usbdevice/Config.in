## package/rockchip/usbdevice/Config.in
```kconfig
config BR2_PACKAGE_USBDEVICE
	bool "script for USB device configure"
	help
	  script for USB device configure.
```

## package/rockchip/usbhost/Config.in
```kconfig
config BR2_PACKAGE_USBHOST
	bool "script for USB host configure"
	help
	  script for USB host configure.
```

## package/rockchip/uvc_app/Config.in
```kconfig
config BR2_PACKAGE_UVC_APP
    bool "uvc app"
    select BR2_PACKAGE_LIBDRM
    select BR2_PACKAGE_MPP
    select BR2_PACKAGE_LIBV4L
```

## package/rockchip/xmlrpcpp/Config.in
```kconfig
config BR2_PACKAGE_XMLRPCPP
	bool "xmlrpcpp for ros"
	select BR2_PACKAGE_HOST_CATKIN
	select BR2_PACKAGE_CPP_COMMON
	select BR2_PACKAGE_ROSTIME
	select BR2_PACKAGE_GTEST
	help
		XmlRpc++ is a C++ implementation of the XML-RPC protocol. This version is heavily modified from the package available on SourceForge in order to support roscpp's threading model. As such, we are maintaining our own fork.
```
