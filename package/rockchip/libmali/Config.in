## package/rockchip/libmali/Config.in
```kconfig
config BR2_PACKAGE_LIBMALI
	bool "rockchip libmali"
	depends on BR2_TOOLCHAIN_USES_GLIBC
	depends on BR2_aarch64 || (BR2_ARM_EABIHF && BR2_arm)
	select BR2_PACKAGE_LIBDRM
	select BR2_PACKAGE_HAS_LIBEGL if !BR2_PACKAGE_LIBMALI_ONLY_CL
	select BR2_PACKAGE_HAS_LIBGLES if !BR2_PACKAGE_LIBMALI_ONLY_CL
	select BR2_PACKAGE_HAS_LIBOPENCL if !BR2_PACKAGE_LIBMALI_WITHOUT_CL
	select BR2_PACKAGE_HAS_LIBEGL_WAYLAND if !BR2_PACKAGE_LIBMALI_ONLY_CL && \
		!BR2_PACKAGE_LIBMALI_DUMMY
	help
	  Install the binary user-space library for the ARM Mali GPU.
	  This package requires a kernel with the ARM Mali GPU Kernel
	  Drivers enabled.

if BR2_PACKAGE_LIBMALI

config BR2_PACKAGE_PROVIDES_LIBEGL
	default "libmali" if !BR2_PACKAGE_LIBMALI_ONLY_CL

config BR2_PACKAGE_PROVIDES_LIBGLES
	default "libmali" if !BR2_PACKAGE_LIBMALI_ONLY_CL

# NOTE: utgard doesn't provide opencl
config BR2_PACKAGE_PROVIDES_LIBOPENCL
	default "libmali" if !BR2_PACKAGE_LIBMALI_WITHOUT_CL

config BR2_PACKAGE_LIBMALI_WITHOUT_CL
	depends on !BR2_PACKAGE_LIBMALI_ONLY_CL
	bool "libmali without opencl"
	help
	  Select libmali without OpenCL.

config BR2_PACKAGE_LIBMALI_ONLY_CL
	bool "libmali with opencl only(also disable display features)"
	help
	  Select libmali with OpenCL only.

config BR2_PACKAGE_LIBMALI_DUMMY
	bool "libmali with dummy platform"
	help
	  Select libmali with dummy platform.
endif
```

## package/rockchip/linux-rga/Config.in
```kconfig
config BR2_PACKAGE_LINUX_RGA
	bool "Rockchip RGA lib for linux"
	select BR2_PACKAGE_LIBDRM if !BR2_PACKAGE_RV1108
	help
	  Rockchip RGA lib for linux.
```

## package/rockchip/mali-rockchip/Config.in
```kconfig
config BR2_PACKAGE_MALI_ROCKCHIP
	bool "mali-rockchip"
	select BR2_PACKAGE_HAS_LIBEGL
	help
	  Install the binary user-space components for the ARM Mali Midgard
	  T76X GPU. This package requires a kernel with the ARM Mali Midgard
	  GPU Kernel Drivers enabled.

	  Source: http://malideveloper.arm.com/resources/drivers/

if BR2_PACKAGE_MALI_ROCKCHIP

config BR2_PACKAGE_PROVIDES_LIBEGL
	default "mali-rockchip"

config BR2_PACKAGE_PROVIDES_LIBGLES
	default "mali-rockchip"

endif
```

## package/rockchip/mediaserver/Config.in
```kconfig
menuconfig BR2_PACKAGE_MEDIASERVER
	bool "rockchip mediaserver"
	select BR2_PACKAGE_DBUS
	select BR2_PACKAGE_DBUS_CPP
	select BR2_PACKAGE_LIBRKDB
	select BR2_PACKAGE_JSON_FOR_MODERN_CPP
	select BR2_PACKAGE_RKMEDIA
	help
	  rockchip mediaserver

if BR2_PACKAGE_MEDIASERVER

config BR2_PACKAGE_MEDIASERVE_CONIFG
	string "mediaserver config"
	default "none"

config BR2_PACKAGE_MEDIASERVE_LINKAPI
	bool "Enable link api features"
	select BR2_PACKAGE_CJSON
	default n
	help
	  rockchip mediaserver options

config BR2_PACKAGE_MEDIASERVE_MINILOGGER
        bool "Enable miniloger print"
        select BR2_PACKAGE_MINILOGGER
        default y
        help
          rockchip mediaserver options

config BR2_PACKAGE_MEDIASERVE_SHM_SERVER
        bool "Enable shm server"
        select BR2_PACKAGE_SHM_TOOLS
        default n
        help
          rockchip mediaserver options

config BR2_PACKAGE_MEDIASERVE_OSD_SERVER
        bool "Enable osd server"
        select BR2_PACKAGE_FREETYPE
        default n
        help
          rockchip mediaserver options

config BR2_PACKAGE_MEDIASERVE_EXIV2_FEATURE
        bool "Enable exiv2 feature"
        select BR2_PACKAGE_EXIV2
        default n
        help
          rockchip mediaserver options

config BR2_PACKAGE_MEDIASERVE_USE_ROCKFACE
        bool "Enable rockface"
        default y if BR2_PACKAGE_RKMEDIA_ROCKFACE
        help
          rockchip mediaserver options

config BR2_PACKAGE_MEDIASERVE_USE_ROCKX
        bool "Enable rockx"
        default y if BR2_PACKAGE_RKMEDIA_ROCKX
        help
          rockchip mediaserver options

endif
```

## package/rockchip/message-runtime/Config.in
```kconfig
config BR2_PACKAGE_MESSAGE_RUNTIME
	bool "message generation for ROS"
	select BR2_PACKAGE_HOST_CATKIN
	select BR2_PACKAGE_GENCPP
	select BR2_PACKAGE_CPP_COMMON
	select BR2_PACKAGE_ROSCPP_SERIALIZATION
	help
		Package modeling the run-time dependencies for language bindings of messages.
```

## package/rockchip/minigui/Config.in
```kconfig
config BR2_PACKAGE_MINIGUI
	bool "Minigui core lib"
	select BR2_PACKAGE_LIBPNG
	select BR2_PACKAGE_JPEG
	help
          http://www.minigui.org

config BR2_PACKAGE_MINIGUI_ENABLE_RGA
	bool "Minigui use rga"
	depends on BR2_PACKAGE_MINIGUI
	select BR2_PACKAGE_LINUX_RGA
```

## package/rockchip/minigui_desktop/Config.in
```kconfig
config BR2_PACKAGE_MINIGUI_DESKTOP
	bool "Minigui demo desktop"
	depends on BR2_PACKAGE_MINIGUI
	select BR2_PACKAGE_RTC_DEMO
	select BR2_PACKAGE_TSLIB
	select BR2_PACKAGE_LIBPNG12
	select BR2_PACKAGE_JPEG
	select BR2_PACKAGE_FREETYPE
	help
	  Minigui demo desktop
```

## package/rockchip/modeset/Config.in
```kconfig
config BR2_PACKAGE_MODESET
	bool "modeset for Linux"
	depends on BR2_PACKAGE_LIBDRM
	select BR2_PACKAGE_JPEG
```

## package/rockchip/n4/Config.in
```kconfig
config BR2_PACKAGE_N4
    bool "rk n4 camera"
    default n
    select BR2_PACKAGE_LIBV4L
    select BR2_PACKAGE_LIBV4L_UTILS
    select BR2_PACKAGE_RKMEDIA
    help
      rk n4 cif camera on 1808 which is controlled by 3399 via virtual tty
```

## package/rockchip/netserver/Config.in
```kconfig
config BR2_PACKAGE_NETSERVER
	bool "rockchip netserver"
	select BR2_PACKAGE_LIBGDBUS
	select BR2_PACKAGE_LIBRKDB
	help
	  rockchip netserver
```

## package/rockchip/partinit/Config.in
```kconfig
config BR2_PACKAGE_PARTINIT
	bool "script for partition init"
	help
	  script for partition init.
```

## package/rockchip/python-catkin_pkg/Config.in.host
```kconfig
config BR2_PACKAGE_HOST_PYTHON_CATKIN_PKG
	bool "catkin_pkg for ROS"
	select BR2_PACKAGE_PYTHON
	help
		Standalone Python library for the catkin build system
```

## package/rockchip/qsetting/Config.in
```kconfig
config BR2_PACKAGE_QSETTING
	bool "qsetting"
	depends on BR2_PACKAGE_QT5
	select BR2_PACKAGE_DEVICEIO_RELEASE
	select BR2_PACKAGE_BROADCOM_BSA
	help
	  Rockchip setting application based on QT
```

## package/rockchip/recovery/Config.in
```kconfig
config BR2_PACKAGE_RECOVERY
	bool "Rockchip recovery for linux"
    select BR2_PACKAGE_LIBDRM
	select BR2_PACKAGE_LIBPNG
	help
	  Rockchip recovery for linux.
```

## package/rockchip/rk_oem/Config.in
```kconfig
config BR2_PACKAGE_RK_OEM
	bool "Rockchip OEM Partition"
	help
	  If we want to run some special applications which we do not
	  to store in root filesystem. Then we store these in the OEM
	  partition, and mount it on the root directory of "/oem".

if BR2_PACKAGE_RK_OEM

config BR2_PACKAGE_RK_OEM_RESOURCE_DIR
	string "Rockchip OEM Partition Directory"
	default ""
	help
	  Directory to store the OEM applications and resource.

	  The default is ""

config BR2_PACKAGE_RK_OEM_INSTALL_TARGET_DIR
	string "Rockchip OEM Files Install Target Directory"
	default "$(BASE_DIR)/oem"
	help
	  Directory to install the files of OEM target.

	  The default is "$(BASE_DIR)/oem"

config BR2_PACKAGE_RK_OEM_ENABLE_DEBUG
	bool "Enable OEM Target build with debug symbol"
	default n
	help
	  Enable this to build target with debug symbol.

endif
```

## package/rockchip/rkadk/Config.in
```kconfig
config BR2_PACKAGE_RKADK
    bool "rkadk"
    select BR2_PACKAGE_RKMEDIA
    select BR2_PACKAGE_ROCKIT
    help
      rkadk
```

## package/rockchip/rkfacial/Config.in
```kconfig
config BR2_PACKAGE_RKFACIAL
    bool "rk facial"
    select BR2_PACKAGE_ROCKFACE
    select BR2_PACKAGE_LIBDRM
    select BR2_PACKAGE_LINUX_RGA
    select BR2_PACKAGE_SQLITE
    select BR2_PACKAGE_ALSA_LIB
    select BR2_PACKAGE_MPP
    select BR2_PACKAGE_CAMERA_ENGINE_RKISP if BR2_PACKAGE_RK1806
    select BR2_PACKAGE_CAMERA_ENGINE_RKISP if BR2_PACKAGE_RK1808
    select BR2_PACKAGE_CAMERA_ENGINE_RKAIQ if BR2_PACKAGE_RV1126_RV1109

config BR2_PACKAGE_RKFACIAL_USE_WEB_SERVER
    bool "use web server"
    default n
    depends on BR2_PACKAGE_RKFACIAL
    select BR2_PACKAGE_LIBIPCPROTOCOL
    select BR2_PACKAGE_LIBGDBUS
```

## package/rockchip/rkmedia/Config.in
```kconfig
menuconfig BR2_PACKAGE_RKMEDIA
	bool "rkmedia"

if BR2_PACKAGE_RKMEDIA

config BR2_PACKAGE_RKMEDIA_SANITIZER_DYNAMIC
	bool "enable rkmedia sanitizer tools with dynamic linker"
	select BR2_PACKAGE_ADDRESS_SANITIZER
	help
	  Enable rkmedia debug on sanitizer with dynamic linker.

config BR2_PACKAGE_RKMEDIA_SANITIZER_STATIC
	bool "enable rkmedia sanitizer tools with static linker"
	select BR2_PACKAGE_ADDRESS_SANITIZER
	help
	  Enable rkmedia debug on sanitizer with static linker.

config BR2_PACKAGE_RKMEDIA_MPP
    bool "rk mpp wrapper"
    select BR2_PACKAGE_MPP
    help
      wrapped function of rk mpp

if BR2_PACKAGE_RKMEDIA_MPP

config BR2_PACKAGE_RKMEDIA_MPP_ENCODER
    bool "rk mpp encoder"
    default y
    help
      wrapped function of rk mpp encoder

if BR2_PACKAGE_RKMEDIA_MPP_ENCODER
config BR2_PACKAGE_RKMEDIA_MPP_ENCODER_OSD
    bool "rk mpp encoder osd"
    default n
    help
     enable encoder osd function

endif #BR2_PACKAGE_RKMEDIA_MPP_ENCODER

config BR2_PACKAGE_RKMEDIA_MPP_DECODER
    bool "rk mpp decoder"
    default y
    help
      wrapped function of rk mpp decoder

endif # BR2_PACKAGE_RKMEDIA_MPP

config BR2_PACKAGE_RKMEDIA_OGG
    bool "ogg"
    select BR2_PACKAGE_LIBVORBIS
    help
      wrapped function of ogg vorbis

if BR2_PACKAGE_RKMEDIA_OGG

config BR2_PACKAGE_RKMEDIA_OGGVORBIS_DEMUXER
    bool "ogg vorbis demuxer_decode"
    default y
    help
      wrapped function of libvorbisfile

config BR2_PACKAGE_RKMEDIA_OGGVORBIS_MUXER
    bool "ogg vorbis encode_muxer"
    help
      wrapped function of libvorbisenc

endif # BR2_PACKAGE_RKMEDIA_OGG

config BR2_PACKAGE_RKMEDIA_FFMPEG
    bool "ffmpeg"
    depends on BR2_PACKAGE_FFMPEG
    help
      wrapped function of ffmpeg

if BR2_PACKAGE_ALSA_LIB

config BR2_PACKAGE_RKMEDIA_ALSA_PLAYBACK
    bool "alsa playback"
    help
      wrapped function of alsa playback

config BR2_PACKAGE_RKMEDIA_ALSA_CAPTURE
    bool "alsa capture"
    help
      wrapped function of alsa capture

endif # BR2_PACKAGE_ALSA_LIB

config BR2_PACKAGE_RKMEDIA_V4L2_CAPTURE
    bool "camera capture"
    help
      wrapped function of v4l2 capture

config BR2_PACKAGE_RKMEDIA_RKGUARD
    bool "rkguard"
    default y
    help
      wrapped function of through guard

config BR2_PACKAGE_RKMEDIA_RKRGA
    bool "rkrga"
    select BR2_PACKAGE_LINUX_RGA
    help
      wrapped function of librga

config BR2_PACKAGE_RKMEDIA_RKNN
    bool "rknn"
    select BR2_PACKAGE_RKNPU
    help
      wrapped function of rknn

config BR2_PACKAGE_RKMEDIA_ROCKFACE
    bool "rockface"
    select BR2_PACKAGE_RKNPU
    select BR2_PACKAGE_ROCKFACE
    help
      wrapped function of rockface

if BR2_PACKAGE_RKMEDIA_ROCKFACE

config BR2_PACKAGE_RKMEDIA_ROCKFACE_RECOGNIZE
    bool "enable face recognize"
    depends on BR2_PACKAGE_ROCKFACE_FACE_RECOGNITION
    depends on BR2_PACKAGE_SQLITE
    default y
    help
        enable rockface recognize

endif # BR2_PACKAGE_RKMEDIA_ROCKFACE

config BR2_PACKAGE_RKMEDIA_ROCKX
    bool "rockx"
    select BR2_PACKAGE_RKNPU
    select BR2_PACKAGE_ROCKX
    help
      wrapped function of rockx

config BR2_PACKAGE_DRM_DISPLAY_OUTPUT
    bool "drm output"
    select BR2_PACKAGE_LIBDRM
    help
      wrapped function of drm output

config BR2_PACKAGE_RKMEDIA_LIVE555
    bool "live555"
    select BR2_PACKAGE_LIVE555
    help
      live555 is an rtsp server and client

if BR2_PACKAGE_RKMEDIA_LIVE555

config BR2_PACKAGE_RKMEDIA_RTSP_SERVER
    bool "rtsp server"
    help
      live555 rtsp server

if BR2_PACKAGE_RKMEDIA_RTSP_SERVER

config BR2_PACKAGE_RKMEDIA_RTSP_SERVER_H264
    bool "rtsp server h264 session"
    help
      live555 rtsp server h264 session

config BR2_PACKAGE_RKMEDIA_RTSP_SERVER_H265
    bool "rtsp server h265 session"
    help
      live555 rtsp server h265 session

endif # BR2_PACKAGE_RKMEDIA_RTSP_SERVER

endif # BR2_PACKAGE_RKMEDIA_LIVE555

config BR2_PACKAGE_RKMEDIA_MOVE_DETECTION
    bool "rk movedetection wrapper"
    select BR2_PACKAGE_COMMON_ALGORITHM
    select BR2_PACKAGE_COMMON_ALGORITHM_MOVE_DETECT
    help
      wrapped function of rk movedetection algorithm

config BR2_PACKAGE_RKMEDIA_OCCLUSION_DETECTION
    bool "rk occlusion detection wrapper"
    select BR2_PACKAGE_COMMON_ALGORITHM
    select BR2_PACKAGE_COMMON_ALGORITHM_OCCLUSION_DETECT
    help
      wrapped function of rk occlusion detection algorithm

config BR2_PACKAGE_RKMEDIA_ANR
    bool "audio automatic noise reduction algorithm"
    select BR2_PACKAGE_COMMON_ALGORITHM
    select BR2_PACKAGE_COMMON_ALGORITHM_ANR
    help
      wrapped function of automatic noise reduction algorithm

config BR2_PACKAGE_RKMEDIA_AEC
    bool "audio echo cancellation algorithm"
    select BR2_PACKAGE_COMMON_ALGORITHM
    select BR2_PACKAGE_COMMON_ALGORITHM_AEC_ANR_AGC
    help
      wrapped function of echo cancellation algorithm

config BR2_PACKAGE_RKMEDIA_MINILOGGER
    bool "Output log by minilogger"
    select BR2_PACKAGE_MINILOGGER
    help
      Output log by minilogger interface

config BR2_PACKAGE_RKMEDIA_EXAMPLES
    bool "enable rkmedia examples"
    help
      provide examples to show the usage of rkmedia

config BR2_PACKAGE_RKMEDIA_UVC
    bool "rk uvc enable"
    depends on BR2_PACKAGE_UVC_APP
    help
      enable uvc function

endif # BR2_PACKAGE_RKMEDIA
```

## package/rockchip/rknpu-fw/Config.in
```kconfig
config BR2_PACKAGE_RKNPU_FW
	bool "rknpu firmware"
        depends on BR2_PACKAGE_NPU_POWERCTRL
	help
	  "Copy rknpu firmware and upgrade"
```

## package/rockchip/rknpu/Config.in
```kconfig
config BR2_PACKAGE_RKNPU
	bool "rknpu"
	help
	  "Copy rknpu driver and test case"

config BR2_PACKAGE_RKNPU_NTB
	bool "rknpu ntb"
        depends on BR2_PACKAGE_RKNPU
	help
	  "use ntb to communction rknn-toolkit"

config BR2_PACKAGE_RKNPU_PCIE
	bool "rknpu pcie"
	help
	  "Copy rknpu driver and test case for pcie interface"

config BR2_PACKAGE_RKNPU_ACM
	bool "rknpu acm"
        depends on BR2_PACKAGE_RKNPU_PCIE
	help
	  "use acm for camera cmd"

config BR2_PACKAGE_PYTHON_RKNN
        bool "python-rknn"
        depends on BR2_PACKAGE_PYTHON3
        depends on BR2_PACKAGE_PYTHON_NUMPY
        help
          RKNN Python API for Rockchip NPU Hardware.
          Currently only support Rockchip RK1808.
```

## package/rockchip/rkscript/Config.in
```kconfig
config BR2_PACKAGE_RKSCRIPT
	bool "rockchip script"
	help
	  rockchip script for linux use.

config BR2_PACKAGE_USB_MODULE
	bool "rockchip usb module"
	help
	  rockchip usb module support

config BR2_PACKAGE_USB_MODULE_NAME
	string "rockchip usb module name"
	default "phy-rockchip-inno-usb2.ko"
	depends on BR2_PACKAGE_USB_MODULE
	help
		rockchip usb module name
```

## package/rockchip/rksl/Config.in
```kconfig
config BR2_PACKAGE_RKSL
    bool "rksl"
    select BR2_PACKAGE_LIBDRM
    select BR2_PACKAGE_LINUX_RGA
    select BR2_PACKAGE_UVC_APP
    select BR2_PACKAGE_ROCKFACE
    select BR2_PACKAGE_CAMERA_ENGINE_RKISP if BR2_PACKAGE_RK1806
    select BR2_PACKAGE_CAMERA_ENGINE_RKISP if BR2_PACKAGE_RK1808
    select BR2_PACKAGE_CAMERA_ENGINE_RKAIQ if BR2_PACKAGE_RV1126_RV1109
```
