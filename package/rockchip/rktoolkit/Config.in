## package/rockchip/rktoolkit/Config.in
```kconfig
config BR2_PACKAGE_RKTOOLKIT
	bool "rockchip toolkit"
	help
	  rockchip toolkit for linux

config BR2_PACKAGE_IO
	bool "io tool for linux"
	select BR2_PACKAGE_RKTOOLKIT
	help
	  io tool for linux. used to read/write register, memory

config BR2_PACKAGE_UPDATE
	bool "Rockchip OTA update for linux"
	select BR2_PACKAGE_RKTOOLKIT
	help
	  Rockchip OTA update for linux. it is just command without UI.
```

## package/rockchip/rkupdate/Config.in
```kconfig
config BR2_PACKAGE_RKUPDATE
	bool "Rockchip rkupdate for linux"
	select BR2_PACKAGE_LIBCUTILS
	select BR2_PACKAGE_LIBPTHREAD_STUBS
	select BR2_PACKAGE_UTIL_LINUX_LIBUUID
	select BR2_PACKAGE_LIBLOG
	help
	  Rockchip rkupdate for linux.
```

## package/rockchip/rkwifibt/Config.in
```kconfig
menuconfig BR2_PACKAGE_RKWIFIBT
    bool "rkwifibt"

if BR2_PACKAGE_RKWIFIBT
choice
	default BR2_PACKAGE_RKWIFIBT_AWCM256
    prompt "wifi chip support"

config BR2_PACKAGE_RKWIFIBT_AP6181
    bool "AP6181"
config BR2_PACKAGE_RKWIFIBT_AP6255
    bool "AP6255"
config BR2_PACKAGE_RKWIFIBT_AP6256
    bool "AP6256"
config BR2_PACKAGE_RKWIFIBT_AP6212A1
    bool "AP6212A1"
config BR2_PACKAGE_RKWIFIBT_AP6354
    bool "AP6354"
config BR2_PACKAGE_RKWIFIBT_AP6356
    bool "AP6356"
config BR2_PACKAGE_RKWIFIBT_AP6236
    bool "AP6236"
config BR2_PACKAGE_RKWIFIBT_AWCM256
    bool "AW-CM256"
config BR2_PACKAGE_RKWIFIBT_AWNB197
    bool "AW-NAB197"
config BR2_PACKAGE_RKWIFIBT_RTL8723DS
    bool "RTL8723DS"
config BR2_PACKAGE_RKWIFIBT_RTL8723CS
    bool "RTL8723CS"
config BR2_PACKAGE_RKWIFIBT_RTL8189FS
    bool "RTL8189FS"
config BR2_PACKAGE_RKWIFIBT_RTL8821CS
    bool "RTL8821CS"
config BR2_PACKAGE_RKWIFIBT_RK912
    bool "RK912"
config BR2_PACKAGE_RKWIFIBT_COMPATIBLE
    bool "Rockchip Compatible with all supported wifi"
endchoice

config BR2_PACKAGE_RKWIFIBT_BTUART
	string "bt uart"
	default "ttyS4"
	depends on BR2_PACKAGE_RKWIFIBT
	help
		tty that bt used

config BR2_PACKAGE_RKWIFIBT_CHIPNAME
    string
    default "AP6181" if BR2_PACKAGE_RKWIFIBT_AP6181
    default "AP6212A1" if BR2_PACKAGE_RKWIFIBT_AP6212A1
    default "AP6236" if BR2_PACKAGE_RKWIFIBT_AP6236
    default "AP6255" if BR2_PACKAGE_RKWIFIBT_AP6255
    default "AP6256" if BR2_PACKAGE_RKWIFIBT_AP6256
    default "AP6354" if BR2_PACKAGE_RKWIFIBT_AP6354
    default "AP6356" if BR2_PACKAGE_RKWIFIBT_AP6356
    default "AW-CM256" if BR2_PACKAGE_RKWIFIBT_AWCM256
    default "AW-NAB197" if BR2_PACKAGE_RKWIFIBT_AWNB197
    default "RTL8189FS" if BR2_PACKAGE_RKWIFIBT_RTL8189FS
    default "RTL8723DS" if BR2_PACKAGE_RKWIFIBT_RTL8723CS
    default "RTL8723DS" if BR2_PACKAGE_RKWIFIBT_RTL8723DS
    default "RTL8821CS" if BR2_PACKAGE_RKWIFIBT_RTL8821CS
    default "RK912" if BR2_PACKAGE_RKWIFIBT_RK912

config BR2_PACKAGE_RKWIFIBT_VENDOR
    string
    default "BROADCOM" if BR2_PACKAGE_RKWIFIBT_AP6181
    default "BROADCOM" if BR2_PACKAGE_RKWIFIBT_AP6212A1
    default "BROADCOM" if BR2_PACKAGE_RKWIFIBT_AP6236
    default "BROADCOM" if BR2_PACKAGE_RKWIFIBT_AP6255
    default "BROADCOM" if BR2_PACKAGE_RKWIFIBT_AP6256
    default "BROADCOM" if BR2_PACKAGE_RKWIFIBT_AP6354
    default "BROADCOM" if BR2_PACKAGE_RKWIFIBT_AP6356
    default "CYPRESS" if BR2_PACKAGE_RKWIFIBT_AWCM256
    default "CYPRESS" if BR2_PACKAGE_RKWIFIBT_AWNB197
    default "REALTEK" if BR2_PACKAGE_RKWIFIBT_RTL8189FS
    default "REALTEK" if BR2_PACKAGE_RKWIFIBT_RTL8723CS
    default "REALTEK" if BR2_PACKAGE_RKWIFIBT_RTL8723DS
    default "REALTEK" if BR2_PACKAGE_RKWIFIBT_RTL8821CS
    default "ROCKCHIP" if BR2_PACKAGE_RKWIFIBT_RK912

config BR2_PACKAGE_RKWIFIBT_WIFI_KO
    string
    default "bcmdhd.ko" if BR2_PACKAGE_RKWIFIBT_AP6181
    default "bcmdhd.ko" if BR2_PACKAGE_RKWIFIBT_AP6212A1
    default "bcmdhd.ko" if BR2_PACKAGE_RKWIFIBT_AP6236
    default "bcmdhd.ko" if BR2_PACKAGE_RKWIFIBT_AP6255
    default "bcmdhd.ko" if BR2_PACKAGE_RKWIFIBT_AP6256
    default "bcmdhd.ko" if BR2_PACKAGE_RKWIFIBT_AP6354
    default "bcmdhd.ko" if BR2_PACKAGE_RKWIFIBT_AP6356
    default "cywdhd.ko" if BR2_PACKAGE_RKWIFIBT_AWCM256
    default "cywdhd.ko" if BR2_PACKAGE_RKWIFIBT_AWNB197
    default "8723cs.ko" if BR2_PACKAGE_RKWIFIBT_RTL8723CS

config BR2_PACKAGE_RKWIFIBT_BT_FW
    string
    default "bcm43438a1.hcd" if BR2_PACKAGE_RKWIFIBT_AP6212A1
    default "BCM4343B0.hcd" if BR2_PACKAGE_RKWIFIBT_AP6236
    default "BCM4345C0.hcd" if BR2_PACKAGE_RKWIFIBT_AP6255
    default "BCM4345C5.hcd" if BR2_PACKAGE_RKWIFIBT_AP6256
    default "bcm4354a1.hcd" if BR2_PACKAGE_RKWIFIBT_AP6354
    default "BCM4356A2.hcd" if BR2_PACKAGE_RKWIFIBT_AP6356
    default "BCM4345C0.hcd" if BR2_PACKAGE_RKWIFIBT_AWCM256
    default "BCM4343A1.hcd" if BR2_PACKAGE_RKWIFIBT_AWNB197

config BR2_PACKAGE_RKWIFIBT_BT_EN
    string
    default "DISABLE" if BR2_PACKAGE_RKWIFIBT_AP6181
    default "ENABLE" if BR2_PACKAGE_RKWIFIBT_AP6212A1
    default "ENABLE" if BR2_PACKAGE_RKWIFIBT_AP6236
    default "ENABLE" if BR2_PACKAGE_RKWIFIBT_AP6255
    default "ENABLE" if BR2_PACKAGE_RKWIFIBT_AP6256
    default "ENABLE" if BR2_PACKAGE_RKWIFIBT_AP6354
    default "ENABLE" if BR2_PACKAGE_RKWIFIBT_AP6356
    default "ENABLE" if BR2_PACKAGE_RKWIFIBT_AWCM256
    default "ENABLE" if BR2_PACKAGE_RKWIFIBT_AWNB197
    default "DISABLE" if BR2_PACKAGE_RKWIFIBT_RTL8189FS
    default "ENABLE" if BR2_PACKAGE_RKWIFIBT_RTL8723CS
    default "ENABLE" if BR2_PACKAGE_RKWIFIBT_RTL8723DS
    default "ENABLE" if BR2_PACKAGE_RKWIFIBT_RTL8821CS
    default "DISABLE" if BR2_PACKAGE_RKWIFIBT_RK912

endif
```

## package/rockchip/rockchip_test/Config.in
```kconfig
config BR2_PACKAGE_ROCKCHIP_TEST
	bool  "stress test tools"
	select BR2_PACKAGE_STRESSAPPTEST
	select BR2_PACKAGE_DHRYSTONE
	select BR2_PACKAGE_MEMTESTER
	select BR2_PACKAGE_MEMTESTER
	select BR2_PACKAGE_BASH
	select BR2_PACKAGE_IPERF
	help
		function test for Rockchip stress test
```

## package/rockchip/rockx/Config.in
```kconfig
config BR2_PACKAGE_ROCKX
	bool "rockx"
	select BR2_PACKAGE_RKNPU
	help
	  rockchip rknn library
```

## package/rockchip/ros/catkin/Config.in.host
```kconfig
config BR2_PACKAGE_HOST_CATKIN
	bool "catkin host tool for ROS"
    depends on BR2_PACKAGE_PYTHON_ROS_SET
	select BR2_PACKAGE_HOST_PYTHON_CATKIN_PKG
	select BR2_PACKAGE_HOST_PYTHON_EM
	select BR2_PACKAGE_HOST_PYTHON_EMPY
	select BR2_PACKAGE_HOST_PYTHON_PYPARSING
	help
		A CMake-based build system that is used to build all packages in ROS
```

## package/rockchip/ros/geometry2/tf2-py/Config.in
```kconfig
config BR2_PACKAGE_TF2_PY
    bool "tf2-py"
    select BR2_PACKAGE_ROS_COMM_SET
    select BR2_PACAKGE_ROSPY
    select BR2_PACKAGE_TF2
    help
        The tf2_py package
```

## package/rockchip/ros/nodelet-core/test-nodelet-topic-tools/Config.in
```kconfig
config BR2_PACKAGE_TEST_NODELET_TOPIC_TOOLS
	bool "test nodelet topic tools"
	select BR2_PACKAGE_MESSAGE_FILTERS
	select BR2_PACKAGE_NODELET
	select BR2_PACKAGE_NODELET_TOPIC_TOOLS
	depends on BR2_PACKAGE_PLUGINLIB
	select BR2_PACKAGE_ROSCPP
	select BR2_PACKAGE_ROSTEST
	help
		test nodelet topic tools
```

## package/rockchip/ros/nodelet-core/test-nodelet/Config.in
```kconfig
config BR2_PACKAGE_TEST_NODELET
	bool "test nodelet"
	select BR2_PACKAGE_NODELET
	depends on BR2_PACKAGE_PLUGINLIB
	select BR2_PACKAGE_ROSTEST
	depends on BR2_PACKAGE_BOOST
	select BR2_PACKAGE_BOOST_THREAD
	help
		test nodelet
```

## package/rockchip/rosconsole/Config.in
```kconfig
config BR2_PACKAGE_ROSCONSOLE
	bool "rosconsole for ros"
	select BR2_PACKAGE_HOST_CATKIN
	select BR2_PACKAGE_ROSUNIT
	select BR2_PACKAGE_BOOST_REGEX
	select BR2_PACKAGE_CPP_COMMON
	select BR2_PAKCAGE_ROSTIME
	help
		ROS console output library.
```

## package/rockchip/rostest/Config.in
```kconfig
config BR2_PACKAGE_ROSTEST
	bool "rostest for ros"
	select BR2_PACKAGE_HOST_CATKIN
	select BR2_PACKAGE_ROSUNIT
	help
		Integration test suite based on roslaunch that is compatible with xUnit frameworks.
```

## package/rockchip/rostime/Config.in
```kconfig
config BR2_PACKAGE_ROSTIME
	bool "rostime in roscpp_core for ROS"
	select BR2_PACKAGE_CPP_COMMON
	select BR2_PACKAGE_BOOST
	select BR2_PACKAGE_BOOST_DATE_TIME
	select BR2_PACKAGE_HOST_CATKIN
	help
	  Time and Duration implementations for C++ libraries
```

## package/rockchip/rosunit/Config.in
```kconfig
config BR2_PACKAGE_ROSUNIT
	bool "rosunit for ros"
	select BR2_PACKAGE_HOST_CATKIN
	help
		Unit-testing package for ROS. This is a lower-level library for rostest and handles unit tests, whereas rostest handles integration tests.
```

## package/rockchip/rv1108_package/Config.in
```kconfig
if BR2_PACKAGE_RV1108

menu "rv1108 package"

# BSP packages
menu "apps"
source "package/rockchip/rv1108_package/apps/Config.in"
endmenu

menu "framework"
source "package/rockchip/rv1108_package/frameworks/Config.in"
endmenu

menu "external"
source "package/rockchip/rv1108_package/external/Config.in"
endmenu

endmenu

endif
```

## package/rockchip/rv1108_package/app/cvr/Config.in
```kconfig
if BR2_PACKAGE_RV1108

# BSP packages
config BR2_PACKAGE_CVR
	bool "RV1108 package CVR application"
	select BR2_PACKAGE_RKCAMERA
	select BR2_PACKAGE_RKFB
	select BR2_PACKAGE_PROCESS_UNITS
	select BR2_PACKAGE_LIBPNG12
	select BR2_PACKAGE_RV1108_MINIGUI
	select BR2_PACKAGE_TSLIB
	select BR2_PACKAGE_JPEG
	select BR2_PACKAGE_RKNR

if BR2_PACKAGE_CVR
menu "cvr setting options"

	config BR2_PACKAGE_CVR_VIDEO_RECORD
		bool "support video record."
		default y
		select BR2_PACKAGE_ADK_MEDIA
		select BR2_PACKAGE_ADK_MEDIA_VIDEO_RECORD
endmenu
endif

endif
```

## package/rockchip/rv1108_package/app/peephole/Config.in
```kconfig
if BR2_PACKAGE_RV1108

# BSP packages
config BR2_PACKAGE_PEEPHOLE
	bool "rv1108 package peephole"
	select BR2_PACKAGE_MESSENGER
endif
```

## package/rockchip/rv1108_package/apps/Config.in
```kconfig
if BR2_PACKAGE_RV1108

# BSP packages
source "package/rockchip/rv1108_package/apps/at_server/Config.in"
source "package/rockchip/rv1108_package/apps/face_service/Config.in"
source "package/rockchip/rv1108_package/apps/lock/Config.in"
source "package/rockchip/rv1108_package/apps/pcba_test/Config.in"
source "package/rockchip/rv1108_package/apps/peephole/Config.in"
source "package/rockchip/rv1108_package/apps/updater/Config.in"
source "package/rockchip/rv1108_package/apps/rv1108_uvc_app/Config.in"
source "package/rockchip/rv1108_package/apps/system_manager/Config.in"

endif
```

## package/rockchip/rv1108_package/apps/face_service/Config.in
```kconfig
if BR2_PACKAGE_RV1108

# BSP packages
config BR2_PACKAGE_FACE_SERVICE
	bool "rv1108 package face sevice"
	select BR2_PACKAGE_MESSENGER
	select BR2_PACKAGE_LIBCAMERAHAL
	select BR2_PACKAGE_DATABASE
	select BR2_PACKAGE_SQLITE
	select BR2_PACKAGE_ADK

if BR2_PACKAGE_FACE_SERVICE
menu "face_service setting options"

	config RV_TARGET_MAIN_APP_PRE_FACE_ROTATE
        int "Image rotation angle before face algorithm"
        default 0

    config RV_TARGET_FACE_DETECT_WIDTH
        int "Face downscale image width"
        default 320

    config RV_TARGET_FACE_DETECT_HEIGHT
        int "Face downscale image height"
        default 240

    config RV_TARGET_MAX_FEATURE_OF_USER
        int "Extract multiple face features when registering."
        default 3

    config RV_TARGET_FACE_CAPTURE
        bool "Enable Face Capture"
        default n
        select RV_TARGET_RKMEDIA
        select RV_TARGET_RKMEDIA_MPP

    config RV_TARGET_ENCODE_H264
        bool "Enable h264 encoder"
        default n
        select RV_TARGET_RKMEDIA
        select RV_TARGET_RKMEDIA_MPP

    config RV_TARGET_3D_LIVE_DETECTION
        bool "Support rk 3D live detection"
        default n

        if RV_TARGET_3D_LIVE_DETECTION
            config RV_TARGET_DEPTH_WIDTH
                int "Depth image width"
                default 640

            config RV_TARGET_DEPTH_HEIGHT
                int "Depth image height"
                default 360
        endif

    config RV_TARGET_FACE_USE_UVC
        bool "use UVC"
        default n
        select RV_TARGET_MPP
        select RV_TARGET_LIBRKUVC
        select RV_TARGET_CONFIG_UVC_RGA

    config RV_TARGET_FACE_USE_MJPEG_CAMERA
        bool "use MJPEG camera"
        default n
        select RV_TARGET_MPP

endmenu
endif

endif
```

## package/rockchip/rv1108_package/apps/pcba_test/Config.in
```kconfig
if BR2_PACKAGE_RV1108

# BSP packages
config BR2_PACKAGE_PCBA_TEST
	bool "rv1108 package pcba_test"

endif
```

## package/rockchip/rv1108_package/apps/rv1108_uvc_app/Config.in
```kconfig
if BR2_PACKAGE_RV1108

# BSP packages
config BR2_PACKAGE_RV1108_UVC_APP
	bool "rv1108 package uvc app"
	select BR2_PACKAGE_MPP
	select BR2_PACKAGE_LIBRKUVC
	select BR2_PACKAGE_JHEAD
	select BR2_PACKAGE_LIBCAMERAHAL
	select BR2_PACKAGE_LIBRKFB
	select BR2_PACKAGE_LIBRKRGA
	select BR2_PACKAGE_SQLITE

if BR2_PACKAGE_RV1108_UVC_APP
menu "uvc app setting options"
config BR2_PACKAGE_RV1108_UVC_APP_ISP_FORMAT
    string "ISP video capture format"
    default "HAL_FRMAE_FMT_NV12"
config BR2_PACKAGE_RV1108_UVC_APP_CIF_FORMAT
    string "CIF video capture format"
    default "HAL_FRMAE_FMT_NV12"
endmenu
endif
endif
```

## package/rockchip/rv1108_package/board/Config.in
```kconfig
config BR2_RV1108_BOARD_VERSION
        string "Board version"
        default "rv1108-lock-evb-v10"

#
# LCD Info
#
menu "lcd infomation"

config BR2_RV1108_LCD_RESOLUTION
	string "LCD resolution"
	default "360x640"

config BR2_RV1108_LCD_BACKLIGHT_HIGH
	int "LCD backlight high value"
	default 250

config BR2_RV1108_LCD_BACKLIGHT_MEDIAN
	int "LCD backlight median value"
	default 200

config BR2_RV1108_LCD_BACKLIGHT_LOW
	int "LCD backlight low value"
	default 150
endmenu
```

## package/rockchip/rv1108_package/external/Config.in
```kconfig
if BR2_PACKAGE_RV1108

# BSP packages
source "package/rockchip/rv1108_package/external/libion/Config.in"
source "package/rockchip/rv1108_package/external/librkfb/Config.in"
source "package/rockchip/rv1108_package/external/librkrga/Config.in"
source "package/rockchip/rv1108_package/external/libnanomsg/Config.in"
source "package/rockchip/rv1108_package/external/libcamerahal/Config.in"
source "package/rockchip/rv1108_package/external/rv1108_minigui/Config.in"
source "package/rockchip/rv1108_package/external/rv1108_libpng/Config.in"
source "package/rockchip/rv1108_package/external/rv1108_softapdemo/Config.in"
source "package/rockchip/rv1108_package/external/rv1108_softapserver/Config.in"

endif
```
