## package/rockchip/rv1108_package/external/libcamerahal/Config.in
```kconfig
if BR2_PACKAGE_RV1108

# BSP packages
config BR2_PACKAGE_LIBCAMERAHAL
	bool "rv1108 package libcamerahal"
	select BR2_PACKAGE_LIBION

if BR2_PACKAGE_LIBCAMERAHAL
menu "libcamerahal options"
config BR2_PACKAGE_LIBCAMERAHAL_USE_IQ_BIN
	bool "use iq bin replace xml"
	default n

config BR2_PACKAGE_LIBCAMERAHAL_IQ_BIN_NAME
	string "iq bin name"
	default "name_not_exist"
	depends on BR2_PACKAGE_LIBCAMERAHAL_USE_IQ_BIN

endmenu
endif

endif
```

## package/rockchip/rv1108_package/external/libnanomsg/Config.in
```kconfig
if BR2_PACKAGE_RV1108

# BSP packages
config BR2_PACKAGE_LIBNANOMSG
	bool "rv1108 package nanomsg"
	help

endif
```

## package/rockchip/rv1108_package/external/librkfb/Config.in
```kconfig
if BR2_PACKAGE_RV1108

# BSP packages
config BR2_PACKAGE_LIBRKFB
	bool "rv1108 package librkfb"
	help

if BR2_PACKAGE_LIBRKFB
menu "framebuffer"

choice
        prompt "HDMI max resolution"
        default BR2_PACKAGE_LIBRKFB_HDMI_MAX_720
        help
          Select HDMI max resolution

config BR2_PACKAGE_LIBRKFB_HDMI_MAX_720
        bool "720P"
        help
          HDMI max resolution 720P

config BR2_PACKAGE_LIBRKFB_HDMI_MAX_1080
        bool "1080P"
        help
          HDMI max resolution 1080P

endchoice

endmenu

endif

endif
```

## package/rockchip/rv1108_package/external/librkrga/Config.in
```kconfig
if BR2_PACKAGE_RV1108

# BSP packages
config BR2_PACKAGE_LIBRKRGA
	bool "rv1108 package librkrga"
	help

endif
```

## package/rockchip/rv1108_package/external/rv1108_minigui/Config.in
```kconfig
if BR2_PACKAGE_RV1108

# BSP packages
config BR2_PACKAGE_RV1108_MINIGUI
	bool "RV1108 package minigui"
	select BR2_PACKAGE_LIBION

if BR2_PACKAGE_RV1108_MINIGUI
menu "RV1108 package minigui options"

config BR2_PACKAGE_RV1108_MINIGUI_STATIC
	bool "enabled static lib"
	default y

endmenu
endif

endif
```

## package/rockchip/rv1108_package/external/rv1108_softapserver/Config.in
```kconfig
if BR2_PACKAGE_RV1108

# BSP packages
config BR2_PACKAGE_RV1108_SOFTAPSERVER
	bool "rv1108 package softapserver"
	help


if BR2_PACKAGE_RV1108_SOFTAPSERVER
config RV_TARGET_SS_REBOOT_AUTOCONNECT
        bool "reboot will auto connect"
        default n

endif

endif
```

## package/rockchip/rv1108_package/framework/Config.in
```kconfig
if BR2_PACKAGE_RV1108

# BSP packages
source "package/rockchip/rv1108_package/framework/adk/Config.in"
source "package/rockchip/rv1108_package/framework/camerahal/Config.in"
source "package/rockchip/rv1108_package/framework/database/Config.in"
source "package/rockchip/rv1108_package/framework/hal/Config.in"
source "package/rockchip/rv1108_package/framework/libion/Config.in"
source "package/rockchip/rv1108_package/framework/librkuvc/Config.in"
source "package/rockchip/rv1108_package/framework/messenger/Config.in"
source "package/rockchip/rv1108_package/framework/model_loader/Config.in"
source "package/rockchip/rv1108_package/framework/process_units/Config.in"
source "package/rockchip/rv1108_package/framework/preisp/Config.in"
source "package/rockchip/rv1108_package/framework/rkcamera/Config.in"
source "package/rockchip/rv1108_package/framework/rkface/Config.in"
source "package/rockchip/rv1108_package/framework/rkfb/Config.in"
source "package/rockchip/rv1108_package/framework/rkrga/Config.in"
source "package/rockchip/rv1108_package/framework/rv1108_settings/Config.in"
source "package/rockchip/rv1108_package/framework/rv1108_vendor_storage/Config.in"

endif
```

## package/rockchip/rv1108_package/framework/adk/Config.in
```kconfig
if BR2_PACKAGE_RV1108

# BSP packages
config BR2_PACKAGE_ADK
	bool "RV1108 package adk"
	select BR2_PACKAGE_LIBION

if BR2_PACKAGE_ADK
menu "adk setting options"

    config BR2_PACKAGE_ADK_MEDIA
        bool "adk media configure."
        default n

    if BR2_PACKAGE_ADK_MEDIA
        config BR2_PACKAGE_ADK_MEDIA_OGG_PLAYBACK
            bool "support adk ogg playback"
            default n
            select BR2_PACKAGE_ALSA_LIB
            select BR2_PACKAGE_RKMEDIA
            select BR2_PACKAGE_RKMEDIA_OGG
            select BR2_PACKAGE_RKMEDIA_OGGVORBIS_DEMUXER
            select BR2_PACKAGE_RKMEDIA_ALSA_PLAYBACK

        config BR2_PACKAGE_ADK_MEDIA_WAV_PLAYBACK
            bool "support adk wav playback"
            default n
            select BR2_PACKAGE_ALSA_LIB
    endif
endmenu
endif

endif
```

## package/rockchip/rv1108_package/framework/camerahal/Config.in
```kconfig
if BR2_PACKAGE_RV1108

# BSP packages
config BR2_PACKAGE_CAMERAHAL
	bool "RV1108 package camerahal"
	select BR2_PACKAGE_LIBION

if BR2_PACKAGE_CAMERAHAL
menu "camerahal options"
config BR2_PACKAGE_CAMERAHAL_USE_IQ_BIN
	bool "use iq bin replace xml"
	default n

config BR2_PACKAGE_CAMERAHAL_IQ_BIN_NAME
	string "iq bin name"
	default "name_not_exist"
	depends on BR2_PACKAGE_CAMERAHAL_USE_IQ_BIN

endmenu
endif

endif
```

## package/rockchip/rv1108_package/framework/model_loader/Config.in
```kconfig
if BR2_PACKAGE_RV1108

# BSP packages
config BR2_PACKAGE_MODEL_LOADER
	bool "rv1108 model loader"

endif
```

## package/rockchip/rv1108_package/framework/rkcamera/Config.in
```kconfig
if BR2_PACKAGE_RV1108

# BSP packages
config BR2_PACKAGE_RKCAMERA
	bool "RV1108 package rkcamera"
	select BR2_PACKAGE_ADK
	select BR2_PACKAGE_CAMERAHAL
	select BR2_PACKAGE_CJSON

endif
```

## package/rockchip/rv1108_package/framework/rkrga/Config.in
```kconfig
if BR2_PACKAGE_RV1108

# BSP packages
config BR2_PACKAGE_RKRGA
	bool "RV1108 package rkrga"
	help

endif
```

## package/rockchip/rv1108_package/frameworks/Config.in
```kconfig
if BR2_PACKAGE_RV1108

# BSP packages
source "package/rockchip/rv1108_package/frameworks/adk/Config.in"
source "package/rockchip/rv1108_package/frameworks/database/Config.in"
source "package/rockchip/rv1108_package/frameworks/hal/Config.in"
source "package/rockchip/rv1108_package/frameworks/librkuvc/Config.in"
source "package/rockchip/rv1108_package/frameworks/messenger/Config.in"
source "package/rockchip/rv1108_package/frameworks/model_loader/Config.in"
source "package/rockchip/rv1108_package/frameworks/preisp/Config.in"
source "package/rockchip/rv1108_package/frameworks/rkcamera/Config.in"
source "package/rockchip/rv1108_package/frameworks/rkface/Config.in"
source "package/rockchip/rv1108_package/frameworks/rv1108_vendor_storage/Config.in"

endif
```

## package/rockchip/rv1108_package/frameworks/adk/Config.in
```kconfig
if BR2_PACKAGE_RV1108

# BSP packages
config BR2_PACKAGE_ADK
	bool "rv1108 package adk"

endif
```

## package/rockchip/rv1108_package/frameworks/librkuvc/Config.in
```kconfig
if BR2_PACKAGE_RV1108

# BSP packages
config BR2_PACKAGE_LIBRKUVC
	bool "rv1108 package librkuvc"
	select BR2_PACKAGE_LIBION
	select BR2_PACKAGE_MPP
	select BR2_PACKAGE_JHEAD

if BR2_PACKAGE_LIBRKUVC
menu "librkuvc setting options"

config BR2_PACKAGE_LIBRKUVC_FORMAT_FILE
    string "use format file"
    default "other"

config BR2_PACKAGE_LIBRKUVC_YUYV_AS_RAW
    bool "YUYV as raw data transfer"
    default n

config BR2_PACKAGE_LIBRKUVC_CONFIG_UVC_RGA
    bool "config uvc rga camera buffer"
    default n

config BR2_PACKAGE_LIBRKUVC_USB_UVC_FUNCTION
    string "usb uvc function"
    default "web_camera_rgb"

endmenu

endif


endif
```

## package/rockchip/rv1108_package/frameworks/messenger/Config.in
```kconfig
if BR2_PACKAGE_RV1108

# BSP packages
config BR2_PACKAGE_MESSENGER
	bool "rv1108 package messenger"
	select BR2_PACKAGE_LIBNANOMSG
	select BR2_PACKAGE_CJSON

endif
```

## package/rockchip/rv1108_package/frameworks/process_units/Config.in
```kconfig
if BR2_PACKAGE_RV1108

# BSP packages
config BR2_PACKAGE_PROCESS_UNITS
	bool "rv1108 package Camera stream processing unit"
	default n
endif
```

## package/rockchip/rv1108_package/frameworks/rkface/Config.in
```kconfig
if BR2_PACKAGE_RV1108

# BSP packages
config BR2_PACKAGE_RKFACE
	bool "rv1108 package Rockchip Face Algorithm"

if BR2_PACKAGE_RKFACE
menu "RK Face Configures"

config BR2_PACKAGE_RKFACE_AUTHORIZATION
    bool "Enable rkface Authorization "
    default n

config BR2_PACKAGE_RKFACE_DETECTION
    bool "Enable rk face detection"
    default y

config BR2_PACKAGE_RKFACE_RECOGNITION
    bool "Enable rk face recognition"
    default y

config BR2_PACKAGE_RKFACE_RKLIVING_DETECTION
    bool "Enable rk living detection"
    default n
endmenu
endif 

endif
```

## package/rockchip/rv1108_package/frameworks/rv1108_vendor_storage/Config.in
```kconfig
if BR2_PACKAGE_RV1108

# BSP packages
config BR2_PACKAGE_RV1108_VENDOR_STORAGE
	bool "rv1108 package vendor storage"

if BR2_PACKAGE_RV1108_VENDOR_STORAGE
menu "vendor storage setting options"

    config RV_TARGET_VENDOR_STORAGE_TEST
        bool "Rockchip vendor storage test"
        default n

endmenu
endif

endif
```

## package/rockchip/sdmount/Config.in
```kconfig
config BR2_PACKAGE_SDMOUNT
	bool "script for sd card mount configure"
	help
	  script for sd card mount configure.
```

## package/rockchip/sensor_msgs/Config.in
```kconfig
config BR2_PACKAGE_SENSOR_MSGS
	bool "sensor msgs for ros"
	select BR2_PACKAGE_HOST_CATKIN
	select BR2_PACKAGE_GEOMETRY_MSGS
	select BR2_PACKAGE_MESSAGE_GENERATION
	select BR2_PACKAGE_STD_MSGS
	help
		This package defines messages for commonly used sensors,
		including cameras and scanning laser rangefinders.
```

## package/rockchip/std-msgs/Config.in
```kconfig
config BR2_PACKAGE_STD_MSGS
	bool "std-msgs for ROS"
	select BR2_PACKAGE_HOST_PYTHON_EM
	select BR2_PACKAGE_HOST_PYTHON_EMPY
	select BR2_PACKAGE_HOST_CATKIN
	select BR2_PACKAGE_MESSAGE_GENERATION
	select BR2_PACKAGE_MESSAGE_RUNTIME
	help
		Contains minimal messages of primitive data types and multiarrays. Intended for quick prototyping, not production use.
```

## package/rockchip/storage_manager/Config.in
```kconfig
config BR2_PACKAGE_STORAGE_MANAGER
	bool "rockchip storage_manager"
	select BR2_PACKAGE_LIBGDBUS
	select BR2_PACKAGE_LIBRKDB
	help
	  rockchip storage_manager
```

## package/rockchip/thunderboot/Config.in
```kconfig
menuconfig BR2_PACKAGE_THUNDERBOOT
	bool "rockchip thunderboot"
	help
	  Rockchip tb(thunder boot) configuration.

if BR2_PACKAGE_THUNDERBOOT
config BR2_PACKAGE_THUNDERBOOT_CAMERA_FPS
	int "camera fps setting"
	default 25
	help
	  Camera fps setting, default is 25fps.

config BR2_THUNDERBOOT_INSTALL_MODULES
	string "dirver modules"
	depends on BR2_PACKAGE_THUNDERBOOT
	help
	  Kernel driver modules to be installed.

config BR2_THUNDERBOOT_SIMPLIFY_USB
	bool "simplify usb configuration"
	depends on BR2_PACKAGE_THUNDERBOOT
	help
	  Kernel driver modules to be installed.

if BR2_THUNDERBOOT_SIMPLIFY_USB

config BR2_THUNDERBOOT_USB_ADBD
	bool "rockchip thunderboot USB ADBD"
	select BR2_PACKAGE_ANDROID_TOOLS
	help
	  Use simplify ADB configuration.

config BR2_THUNDERBOOT_USB_RNDIS
	bool "rockchip thunderboot USB RNDIS"
	help
	  Use simplify RNDIS configuration.
	  Default net device is usb0.
	  Default net address is 190.168.1.100
endif
endif
```

## package/rockchip/updateEngine/Config.in
```kconfig
config BR2_PACKAGE_UPDATEENGINE
	bool "Rockchip updateEngine for linux"
	select BR2_PACKAGE_LIBCURL
	help
	  Rockchip updateEngine for linux.
```
