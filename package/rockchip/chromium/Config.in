## package/rockchip/chromium/Config.in
```kconfig
config BR2_PACKAGE_CHROMIUM
	bool "Rockchip chromium"
	help
	  "rockchip chromium with video hardware acceleration"
```

## package/rockchip/common_algorithm/Config.in
```kconfig
config BR2_PACKAGE_COMMON_ALGORITHM
	bool "rockchip common algorithm"
	help
	  rockchip common algorithm library

if BR2_PACKAGE_COMMON_ALGORITHM

config BR2_PACKAGE_COMMON_ALGORITHM_AEC_ANR_AGC
	bool "audio 3a"

config BR2_PACKAGE_COMMON_ALGORITHM_TWO_MIC_BEAMFORM
	bool "beamforming(two mic)"

config BR2_PACKAGE_COMMON_ALGORITHM_MOVE_DETECT
	bool "move detection"

endif
```

## package/rockchip/console-bridge/Config.in
```kconfig
config BR2_PACKAGE_CONSOLE_BRIDGE
	bool "console_bridge for ros"
	help
	  console_bridge is a ROS-independent, pure CMake (i.e. non-catkin and non-rosbuild package) that provides logging calls that mirror those found in rosconsole, but for applications that are not necessarily using ROS.
```

## package/rockchip/cv_bridge/Config.in
```kconfig
config BR2_PACKAGE_CV_BRIDGE
	bool "cv_bridge for ros"
	select BR2_PACKAGE_HOST_CATKIN
	select BR2_PACKAGE_ROSCONSOLE
	select BR2_PACKAGE_SENSOR_MSGS
	select BR2_PACKAGE_BOOST_PYTHON
	select BR2_PACKAGE_OPENCV3
	select BR2_PACKAGE_OPENCV3_LIB_IMGPROC
	select BR2_PACKAGE_OPENCV3_LIB_IMGCODECS
	select BR2_PACKAGE_HOST_PYTHON_NUMPY
	select BR2_PACKAGE_GTEST
	help
		This contains CvBridge, which converts between ROS Image messages and OpenCV images.
```

## package/rockchip/cypress_bsa/Config.in
```kconfig
config BR2_PACKAGE_CYPRESS_BSA
    bool "broadcom(cypress) bsa server and app"
    default n
    help
	broadcom bsa server and app
```

## package/rockchip/dbserver/Config.in
```kconfig
config BR2_PACKAGE_DBSERVER
	bool "rockchip dbserver"
	select BR2_PACKAGE_LIBGDBUS
	select BR2_PACKAGE_LIBRKDB
	help
	  rockchip dbserver

if BR2_PACKAGE_DBSERVER
config BR2_PACKAGE_DBSERVER_SANITIZER_DYNAMIC
	bool "enable dbserver sanitizer tools with dynamic linker"
	select BR2_PACKAGE_ROCKCHIP_SANITIZER
	help
	  Enable dbserver debug on sanitizer with dynamic linker.

config BR2_PACKAGE_DBSERVER_SANITIZER_STATIC
	bool "enable dbserver sanitizer tools with static linker"
	select BR2_PACKAGE_ROCKCHIP_SANITIZER
	help
	  Enable dbserver debug on sanitizer with static linker.
endif
```

## package/rockchip/deviceio_release/Config.in
```kconfig
config BR2_PACKAGE_DEVICEIO_RELEASE
	bool "prebuilt device io library"
	select BR2_PACKAGE_ALSA_LIB
```

## package/rockchip/dui/Config.in
```kconfig
config BR2_PACKAGE_DUI
	bool "build dui application"
	select BR2_PACKAGE_DEVICEIO
```

## package/rockchip/eq_drc_process/Config.in
```kconfig
config BR2_PACKAGE_EQ_DRC_PROCESS
    bool "Equalizer and DRC process"
    depends on BR2_PACKAGE_DEVICEIO
```

## package/rockchip/ficial_gate/Config.in
```kconfig
config BR2_PACKAGE_FICIAL_GATE
    bool "ficial gate"
    select BR2_PACKAGE_ROCKFACE
    select BR2_PACKAGE_LIBDRM
    select BR2_PACKAGE_LINUX_RGA
    select BR2_PACKAGE_TSLIB
    select BR2_PACKAGE_LIBPNG12
    select BR2_PACKAGE_JPEG
    select BR2_PACKAGE_MINIGUI
    select BR2_PACKAGE_FREETYPE
    select BR2_PACKAGE_SQLITE
    select BR2_PACKAGE_CAMERA_ENGINE_RKISP
    select BR2_PACKAGE_ALSA_LIB
```

## package/rockchip/gencpp/Config.in
```kconfig
config BR2_PACKAGE_GENCPP
	bool "gencpp for ROS"
	select BR2_PACKAGE_HOST_CATKIN
	select BR2_PACKAGE_GENMSG
	help
		ROS C++ message definition and serialization generators
```

## package/rockchip/genlisp/Config.in
```kconfig
config BR2_PACKAGE_GENLISP
	bool "genlisp for ROS"
	select BR2_PACKAGE_HOST_CATKIN
	select BR2_PACKAGE_GENMSG
	select BR2_PACKAGE_GENCPP
	help
		Lisp message generation for ROS
```

## package/rockchip/genmsg/Config.in
```kconfig
config BR2_PACKAGE_GENMSG
	bool "genmsg for ROS"
	select BR2_PACKAGE_HOST_CATKIN
	help
		Standalone Python library for generating ROS message and service data structures for various languages
```

## package/rockchip/genpy/Config.in
```kconfig
config BR2_PACKAGE_GENPY
	bool "genpy for ROS"
	select BR2_PACKAGE_HOST_CATKIN
	select BR2_PACKAGE_GENMSG
	select BR2_PACKAGE_GENCPP
	select BR2_PACKAGE_GENLISP
	help
		The Python ROS message and service generator
```

## package/rockchip/geometry_msgs/Config.in
```kconfig
config BR2_PACKAGE_GEOMETRY_MSGS
	bool "geometry_msgs for ros"
	select BR2_PACKAGE_HOST_CATKIN
	select BR2_PACKAGE_MESSAGE_GENERATION
	select BR2_PACKAGE_STD_MSGS
	help
		geometry_msgs provides messages for common
		geometric primitives such as points, vectors,
		and poses. These primitives are designed to
		provide a common data type and facilitate
		interoperability throughout the system.
```

## package/rockchip/gst-plugins-rockchip/Config.in
```kconfig
config BR2_PACKAGE_GST_PLUGINS_ROCKCHIP
	bool "Gstreamer Rockchip extra plugins"
	depends on BR2_PACKAGE_CAMERA_ENGINE_RKISP
	select BR2_PACKAGE_GST1_PLUGINS_BASE
	select BR2_PACKAGE_LIBV4L
	help
	  GStreamer Rockchip offers graphics/camera for rockchip platform.

          https://github.com/rockchip-linux/gst-plugins-rockchip
```

## package/rockchip/iflytekSDK/Config.in
```kconfig
config BR2_PACKAGE_IFLYTEKSDK
	bool "Simple iflytek voice process and cloud SDK"
```

## package/rockchip/internal-storage/Config.in
```kconfig
config BR2_PACKAGE_INTERNAL_STORAGE
	bool "rockchip internal-storage"
	help
	  udev rule for rockchip internal storage.
```

## package/rockchip/ipc-daemon/Config.in
```kconfig
config BR2_PACKAGE_IPC_DAEMON
	bool "ipc-daemon app"
	help
	  daemon app for ip camera, monitor ipc processes and process system commands
```

## package/rockchip/ipcweb-backend/Config.in
```kconfig
config BR2_PACKAGE_IPCWEB_BACKEND
	bool "ipcweb backend for Linux"
	select BR2_PACKAGE_LIBCGICC
	select BR2_PACKAGE_OPENSSL
	select BR2_PACKAGE_LIBIPCPROTOCOL
	help
		ipcweb backend for Linux
```

## package/rockchip/isp2-ipc/Config.in
```kconfig
config BR2_PACKAGE_ISP2_IPC
	bool "Rockchip ISP Server"
	select BR2_PACKAGE_LIBGDBUS
	select BR2_PACKAGE_LIBRKDB
	help
	  Rockchip ISP server
```

## package/rockchip/ledctr/Config.in
```kconfig
config BR2_PACKAGE_LEDCTR
	bool "Rockchip Led control tool for linux"
	help
	  Rockchip Led control tool for linux.
```

## package/rockchip/libIPCProtocol/Config.in
```kconfig
menuconfig BR2_PACKAGE_LIBIPCPROTOCOL
	bool "rockchip libIPCProtocol"
	select BR2_PACKAGE_LIBGDBUS
	select BR2_PACKAGE_LIBRKDB
	help
	  rockchip libIPCProtocol

if BR2_PACKAGE_LIBIPCPROTOCOL

config BR2_PACKAGE_LIBIPCPROTOCOL_DEMO
	bool "rockchip libIPCProtocol demo"
	help
	  provide demo to show the usage of libIPCProtocol

endif
```
