## configs/rockchip_rk3326_32_defconfig
```kconfig
#include "rk3326_arm.config"
#include "base.config"
#include "base_extra.config"
#include "gpu.config"
#include "display.config"
#include "video_mpp.config"
#include "video_gst.config"
#include "audio.config"
#include "camera.config"
#include "camera_gst.config"
#include "test.config"
#include "debug.config"
#include "benchmark.config"
#include "wifi.config"
#include "bt.config"
#include "qt.config"
#include "qt_app.config"
BR2_TARGET_GENERIC_HOSTNAME="rk3326_32"
BR2_TARGET_GENERIC_ISSUE="Welcome to RK3326 Buildroot"
BR2_ROOTFS_OVERLAY="board/rockchip/rk3326/fs-overlay-32/"
BR2_PACKAGE_RKWIFIBT_COMPATIBLE=y
BR2_PACKAGE_RKWIFIBT_BTUART="ttyS1"
BR2_PACKAGE_DOSFSTOOLS_FATLABEL=y
BR2_PACKAGE_DOSFSTOOLS_FSCK_FAT=y
BR2_PACKAGE_FATRESIZE=y
BR2_PACKAGE_PARTED=y
```

## configs/rockchip_rk3326_64_open_defconfig
```kconfig
#include "rk3326_arm64.config"
#include "base.config"
#include "base_extra.config"
#include "gpu.config"
#include "display.config"
#include "video_mpp.config"
#include "video_gst.config"
#include "audio.config"
#include "camera.config"
#include "camera_gst.config"
#include "test.config"
#include "debug.config"
#include "benchmark.config"
#include "wifi.config"
#include "bt.config"
#include "qt.config"
#include "qt_app.config"
BR2_ARM_ENABLE_NEON=y
BR2_ARM_FPU_NEON_FP_ARMV8=y
BR2_TARGET_GENERIC_HOSTNAME="rk3326_64"
BR2_TARGET_GENERIC_ISSUE="Welcome to RK3326 Buildroot"
BR2_PACKAGE_RKWIFIBT_COMPATIBLE=y
BR2_PACKAGE_RKWIFIBT_BTUART="ttyS1"
BR2_PACKAGE_LIBMALI_WITHOUT_CL=y
BR2_PACKAGE_DOSFSTOOLS_FATLABEL=y
BR2_PACKAGE_DOSFSTOOLS_FSCK_FAT=y
BR2_PACKAGE_FATRESIZE=y
BR2_PACKAGE_PARTED=y
```

## configs/rockchip_rk3326_audio_defconfig
```kconfig
BR2_aarch64=y
BR2_DL_DIR="$(TOPDIR)/download"
BR2_TOOLCHAIN_BUILDROOT_GLIBC=y
BR2_KERNEL_HEADERS_4_4=y
BR2_TOOLCHAIN_BUILDROOT_CXX=y
BR2_ROOTFS_DEVICE_CREATION_DYNAMIC_EUDEV=y
BR2_ROOTFS_OVERLAY="board/rockchip/common/fs-overlay-audio"
BR2_PACKAGE_ROCKCHIP=y
BR2_PACKAGE_RK3326=y
BR2_PACKAGE_IO=y
BR2_PACKAGE_USBDEVICE=y
BR2_PACKAGE_ALSA_UTILS=y
BR2_PACKAGE_ALSA_UTILS_ALSACONF=y
# BR2_PACKAGE_ALSA_UTILS_ALSACTL is not set
BR2_PACKAGE_ALSA_UTILS_AMIXER=y
BR2_PACKAGE_ALSA_UTILS_APLAY=y
BR2_PACKAGE_INPUT_EVENT_DAEMON=y
BR2_PACKAGE_USBMOUNT=y
BR2_PACKAGE_PM_UTILS=y
BR2_PACKAGE_ANDROID_TOOLS=y
BR2_TARGET_ROOTFS_CPIO=y
BR2_TARGET_ROOTFS_CPIO_GZIP=y
BR2_TARGET_ROOTFS_EXT2=y
BR2_TARGET_ROOTFS_EXT2_4=y
BR2_TARGET_ROOTFS_SQUASHFS=y
```

## configs/rockchip_rk3326_defconfig
```kconfig
BR2_aarch64=y
BR2_DL_DIR="$(TOPDIR)/download"
BR2_TOOLCHAIN_BUILDROOT_GLIBC=y
BR2_KERNEL_HEADERS_4_4=y
BR2_TOOLCHAIN_BUILDROOT_CXX=y
BR2_ROOTFS_DEVICE_CREATION_DYNAMIC_EUDEV=y
BR2_ROOTFS_OVERLAY="board/rockchip/rk3326/fs-overlay"
BR2_PACKAGE_ROCKCHIP=y
BR2_PACKAGE_RK3326=y
BR2_PACKAGE_LIBLOG=y
BR2_PACKAGE_LIBCUTILS=y
BR2_PACKAGE_MPP=y
BR2_PACKAGE_MPP_ALLOCATOR_DRM=y
BR2_PACKAGE_ADBD=y
BR2_PACKAGE_GSTREAMER1_ROCKCHIP=y
BR2_PACKAGE_GSTREAMER1_ROCKCHIP_EXTRA=y
BR2_PACKAGE_LINUX_RGA=y
BR2_PACKAGE_UPDATE=y
BR2_PACKAGE_UEVENTD=y
BR2_PACKAGE_IO=y
BR2_PACKAGE_MUSIC=y
BR2_PACKAGE_VIDEO=y
BR2_PACKAGE_CAMERA=y
BR2_PACKAGE_GALLERY=y
BR2_PACKAGE_QLAUNCHER=y
BR2_PACKAGE_SETTINGS=y
BR2_PACKAGE_POWERMANAGER=y
BR2_PACKAGE_AUDIOSERVICE=y
BR2_PACKAGE_ALSA_UTILS=y
BR2_PACKAGE_ALSA_UTILS_ALSACONF=y
BR2_PACKAGE_ALSA_UTILS_ACONNECT=y
BR2_PACKAGE_ALSA_UTILS_ALSALOOP=y
BR2_PACKAGE_ALSA_UTILS_ALSAUCM=y
BR2_PACKAGE_ALSA_UTILS_ALSATPLG=y
BR2_PACKAGE_ALSA_UTILS_AMIDI=y
BR2_PACKAGE_ALSA_UTILS_AMIXER=y
BR2_PACKAGE_ALSA_UTILS_APLAY=y
BR2_PACKAGE_ALSA_UTILS_APLAYMIDI=y
BR2_PACKAGE_ALSA_UTILS_ARECORDMIDI=y
BR2_PACKAGE_ALSA_UTILS_ASEQDUMP=y
BR2_PACKAGE_ALSA_UTILS_ASEQNET=y
BR2_PACKAGE_ALSA_UTILS_BAT=y
BR2_PACKAGE_ALSA_UTILS_IECSET=y
BR2_PACKAGE_ALSA_UTILS_SPEAKER_TEST=y
BR2_PACKAGE_GSTREAMER1=y
BR2_PACKAGE_GSTREAMER1_MM=y
BR2_PACKAGE_GST1_PLUGINS_BAD=y
BR2_PACKAGE_GST1_PLUGINS_UGLY=y
BR2_PACKAGE_GST1_LIBAV=y
BR2_PACKAGE_GST1_RTSP_SERVER=y
BR2_PACKAGE_PULSEAUDIO=y
BR2_PACKAGE_PULSEAUDIO_DAEMON=y
BR2_PACKAGE_DHRYSTONE=y
BR2_PACKAGE_LMBENCH=y
BR2_PACKAGE_STRACE=y
BR2_PACKAGE_STRESSAPPTEST=y
BR2_PACKAGE_UNIXBENCH=y
BR2_PACKAGE_SQUASHFS=y
BR2_PACKAGE_MESA3D=y
BR2_PACKAGE_MESA3D_GALLIUM_DRIVER_SWRAST=y
BR2_PACKAGE_MESA3D_DRI_DRIVER_SWRAST=y
BR2_PACKAGE_MESA3D_OSMESA=y
BR2_PACKAGE_MESA3D_OPENGL_EGL=y
BR2_PACKAGE_MESA3D_OPENGL_ES=y
BR2_PACKAGE_MESA3D_OPENGL_TEXTURE_FLOAT=y
BR2_PACKAGE_QT5=y
BR2_PACKAGE_QT53D=y
BR2_PACKAGE_QT5BASE_OPENGL_ES2=y
BR2_PACKAGE_QT5BASE_HARFBUZZ=y
BR2_PACKAGE_QT5BASE_GIF=y
BR2_PACKAGE_QT5BASE_JPEG=y
BR2_PACKAGE_QT5BASE_PNG=y
BR2_PACKAGE_QT5CONNECTIVITY=y
BR2_PACKAGE_QT5MULTIMEDIA=y
BR2_PACKAGE_QT5QUICKCONTROLS=y
BR2_PACKAGE_QT5WAYLAND=y
BR2_PACKAGE_QT5WAYLAND_COMPOSITOR=y
BR2_PACKAGE_WESTON=y
BR2_PACKAGE_WESTON_DRM=y
BR2_PACKAGE_WESTON_XWAYLAND=y
BR2_PACKAGE_XORG7=y
BR2_PACKAGE_EVTEST=y
BR2_PACKAGE_INPUT_EVENT_DAEMON=y
BR2_PACKAGE_PM_UTILS=y
BR2_PACKAGE_LIBEPOXY=y
BR2_PACKAGE_BLUEZ_TOOLS=y
BR2_PACKAGE_BLUEZ5_UTILS=y
BR2_PACKAGE_BLUEZ5_UTILS_OBEX=y
BR2_PACKAGE_BLUEZ5_UTILS_CLIENT=y
BR2_PACKAGE_BLUEZ5_UTILS_GATTTOOL=y
BR2_PACKAGE_BLUEZ5_UTILS_EXPERIMENTAL=y
BR2_PACKAGE_BLUEZ5_PLUGINS_SIXAXIS=y
BR2_PACKAGE_CONNMAN=y
BR2_PACKAGE_CONNMAN_WIFI=y
BR2_PACKAGE_CONNMAN_BLUETOOTH=y
BR2_PACKAGE_DNSMASQ=y
BR2_PACKAGE_ETHTOOL=y
BR2_PACKAGE_HOSTAPD=y
BR2_PACKAGE_HOSTAPD_DRIVER_RTW=y
BR2_PACKAGE_HOSTAPD_EAP=y
BR2_PACKAGE_HOSTAPD_WPS=y
BR2_PACKAGE_IPERF3=y
BR2_PACKAGE_IW=y
BR2_TARGET_ROOTFS_EXT2=y
BR2_TARGET_ROOTFS_EXT2_4=y
BR2_TARGET_ROOTFS_EXT2_SIZE="350M"
# BR2_TARGET_ROOTFS_TAR is not set
```

## configs/rockchip_rk3326_nano_defconfig
```kconfig
BR2_aarch64=y
BR2_DL_DIR="$(TOPDIR)/download"
BR2_TOOLCHAIN_BUILDROOT_GLIBC=y
BR2_KERNEL_HEADERS_4_4=y
BR2_TOOLCHAIN_BUILDROOT_CXX=y
BR2_ROOTFS_OVERLAY="board/rockchip/rk3326/fs-overlay-nano"
BR2_PACKAGE_ROCKCHIP=y
BR2_PACKAGE_RK3326=y
BR2_PACKAGE_LIBLOG=y
BR2_PACKAGE_LIBCUTILS=y
BR2_PACKAGE_ADBD=y
BR2_PACKAGE_IO=y
BR2_TARGET_ROOTFS_CPIO=y
BR2_TARGET_ROOTFS_CPIO_GZIP=y
```

## configs/rockchip_rk3326_recovery_defconfig
```kconfig
rockchip_rk3326_arch_arm64_defconfig
rockchip_nano_defconfig
rockchip_recovery_defconfig
BR2_TEST
```

## configs/rockchip_rk3326_robot_defconfig
```kconfig
#include "rk3326_arm64.config"
#include "base.config"
#include "base_extra.config"
#include "gpu.config"
#include "audio.config"
#include "wifi.config"
#include "debug.config"
BR2_PACKAGE_RKWIFIBT_COMPATIBLE=y
```

## configs/rockchip_rk3399pro-npu-multi-cam_defconfig
```kconfig
#include "rk3399pro_npu_arm64.config"
#include "base.config"
BR2_ROOTFS_DEVICE_CREATION_DYNAMIC_EUDEV=y
BR2_PACKAGE_CAMERA_ENGINE_RKISP=y
BR2_PACKAGE_ROCKCHIP_TEST=y
BR2_PACKAGE_RKNPU_PCIE=y
BR2_PACKAGE_RKNPU_ACM=y
BR2_PACKAGE_LIBUSB=y
BR2_PACKAGE_LIBV4L=y
BR2_PACKAGE_LIBV4L_UTILS=y
BR2_PACKAGE_LIBXML2=y
BR2_PACKAGE_PROCRANK_LINUX=y
BR2_PACKAGE_RKTOOLKIT=y
BR2_PACKAGE_ROCKCHIP_TEST=y
BR2_PACKAGE_RKSCRIPT=y
BR2_PACKAGE_LIBDRM=y
BR2_PACKAGE_LIBDRM_INSTALL_TESTS=y
BR2_PACKAGE_N4=y
#  - input event daemon used to handle key event, ie. power on/off system
BR2_PACKAGE_INPUT_EVENT_DAEMON=y
BR2_PACKAGE_PM_UTILS=y
```

## configs/rockchip_rk3399pro_defconfig
```kconfig
#include "rk3399pro_arm64.config"
#include "base.config"
#include "base_extra.config"
#include "gpu.config"
#include "display.config"
#include "demo.config"
#include "video_mpp.config"
#include "video_gst.config"
#include "video_gst_rtsp.config"
#include "audio.config"
#include "camera.config"
#include "camera_gst.config"
#include "test.config"
#include "debug.config"
#include "benchmark.config"
#include "wifi.config"
#include "bt.config"
#include "qt.config"
#include "qt_app.config"
#include "ntfs.config"
BR2_ROOTFS_OVERLAY="board/rockchip/rk3399pro/fs-overlay-64/"
BR2_TARGET_GENERIC_HOSTNAME="rk3399pro"
BR2_TARGET_GENERIC_ISSUE="Welcome to RK3399PRO Buildroot"
BR2_PACKAGE_RKWIFIBT_COMPATIBLE=y
BR2_PACKAGE_RKWIFIBT_BTUART="ttyS0"
BR2_PACKAGE_MINIGUI_ENABLE_RGA=y
BR2_PACKAGE_MINIGUI_ENABLE_FREETYPE=y
BR2_PACKAGE_MINIGUI_ENABLE_PNG=y
BR2_PACKAGE_NPU_POWERCTRL=y
BR2_PACKAGE_RKNN_DEMO=y
BR2_PACKAGE_RKNN_DEMO_ENABLE_SSD=y
```

## configs/rockchip_rv1108_cvr_defconfig
```kconfig
#include "rv1108_arm.config"
#include "rv1108_base.config"
#include "rv1108_cvr.config"
#include "rv1108_media.config"
BR2_PACKAGE_DEVICE_MANAGER=y
BR2_PACKAGE_DEVICE_MANAGER_IPC_NANOMSG=y
BR2_PACKAGE_SYSTEM_MANAGER=y
BR2_PACKAGE_IO=y
BR2_PACKAGE_DOSFSTOOLS=y
BR2_PACKAGE_DOSFSTOOLS_FATLABEL=y
BR2_PACKAGE_DOSFSTOOLS_FSCK_FAT=y
BR2_PACKAGE_DOSFSTOOLS_MKFS_FAT=y
BR2_PACKAGE_PARTED=y
```

## configs/rockchip_rv1108_lock_defconfig
```kconfig
#include "rv1108_arm.config"
#include "rv1108_base.config"
#include "rv1108_lock.config"
#include "rv1108_face_service.config"
#include "rv1108_system_manager.config"
#include "network.config"
#include "adbd.config"
BR2_PACKAGE_ADK_MEDIA=y
BR2_PACKAGE_ADK_MEDIA_WAV_PLAYBACK=y
```

## configs/rockchip_rv1126_battery_ipc_defconfig
```kconfig
#include "tinyrootfs.config"
#include "arm_a7.config"
#include "gcc8.config"
BR2_TARGET_GENERIC_HOSTNAME="RV1126_RV1109"
BR2_TARGET_GENERIC_ISSUE="Welcome to Battery IPC"
BR2_TARGET_GENERIC_ROOT_PASSWD="rockchip"
BR2_TARGET_GENERIC_GETTY_PORT="ttyFIQ0"
BR2_TARGET_GENERIC_GETTY_BAUDRATE_1500000=y
BR2_ROOTFS_OVERLAY="board/rockchip/rv1126_rv1109/fs-overlay-battery-ipc"
BR2_ROOTFS_POST_BUILD_SCRIPT="board/rockchip/common/tinyrootfs/post-build-tinyrootfs.sh"
BR2_PACKAGE_RV1126_RV1109=y
BR2_PACKAGE_MPP_ALLOCATOR_DRM=y
BR2_PACKAGE_RKMEDIA_MPP=y
# BR2_PACKAGE_RKMEDIA_MPP_DECODER is not set
BR2_PACKAGE_RKMEDIA_FFMPEG=y
BR2_PACKAGE_RKMEDIA_ALSA_PLAYBACK=y
BR2_PACKAGE_RKMEDIA_ALSA_CAPTURE=y
BR2_PACKAGE_RKMEDIA_V4L2_CAPTURE=y
# BR2_PACKAGE_RKMEDIA_RKGUARD is not set
BR2_PACKAGE_RKMEDIA_RKRGA=y
BR2_PACKAGE_RKMEDIA_LIVE555=y
BR2_PACKAGE_RKMEDIA_RTSP_SERVER=y
BR2_PACKAGE_RKMEDIA_RTSP_SERVER_H264=y
BR2_PACKAGE_RKMEDIA_ANR=y
BR2_PACKAGE_RKMEDIA_AEC=y
# BR2_PACKAGE_MINIGUI_SOFTWARE_SCALE is not set
BR2_PACKAGE_MEDIASERVER=y
BR2_PACKAGE_MEDIASERVE_CONIFG="tb_rtsp-link.conf"
# BR2_PACKAGE_MEDIASERVE_DBUS is not set
BR2_PACKAGE_MEDIASERVE_LINKAPI=y
# BR2_PACKAGE_MEDIASERVE_MINILOGGER is not set
BR2_PACKAGE_MEDIASERVE_TB=y
BR2_PACKAGE_CAMERA_ENGINE_RKAIQ=y
BR2_PACKAGE_CAMERA_ENGINE_RKAIQ_IQFILE="ov2718_YT-RV1109-3-V1_M43-4IR-2MP-F2.xml"
BR2_PACKAGE_CAMERA_ENGINE_RKAIQ_IQFILE_USE_BIN=y
BR2_PACKAGE_ISP2_IPC=y
BR2_PACKAGE_LIBV4L=y
BR2_PACKAGE_FFMPEG=y
BR2_PACKAGE_FFMPEG_ENCODERS="pcm_alaw pcm_s16"
BR2_PACKAGE_FFMPEG_DECODERS="pcm_alaw pcm_s16"
BR2_PACKAGE_FFMPEG_MUXERS=""
BR2_PACKAGE_FFMPEG_DEMUXERS=""
BR2_PACKAGE_FFMPEG_PARSERS=""
BR2_PACKAGE_FFMPEG_BSFS=""
BR2_PACKAGE_FFMPEG_PROTOCOLS=""
BR2_PACKAGE_FFMPEG_FILTERS=""
BR2_PACKAGE_LIBV4L_UTILS=y
BR2_PACKAGE_EXPAT=y
BR2_PACKAGE_JSON_C=y
BR2_PACKAGE_LIBGLIB2=y
# BR2_PACKAGE_IFUPDOWN_SCRIPTS is not set
BR2_PACKAGE_WPA_SUPPLICANT=y
BR2_PACKAGE_WPA_SUPPLICANT_EAP=y
```

## configs/rockchip_rv1126_robot_recovery_defconfig
```kconfig
#include "base.config"
#include "base_extra.config"
#include "rv1126_rv1109_arm.config"
#include "recovery.config"
BR2_ROOTFS_OVERLAY="board/rockchip/rv1126_rv1109/fs-overlay-recovery/"
BR2_PACKAGE_RECOVERY_NO_UI=y
BR2_TARGET_ROOTFS_EXT2_MKFS_OPTIONS="-O ^64bit,^huge_file"
```

## configs/rockchip_rv1126_rv1109_libs_defconfig
```kconfig
#include "audio.config"
#include "video_mpp.config"
#include "rv1126_rv1109_arm.config"
BR2_PACKAGE_ROCKCHIP=y
BR2_PACKAGE_RKMEDIA_MPP=y
BR2_PACKAGE_RKMEDIA_MPP_ENCODER_OSD=y
BR2_PACKAGE_RKMEDIA_FFMPEG=y
BR2_PACKAGE_RKMEDIA_ALSA_CAPTURE=y
BR2_PACKAGE_RKMEDIA_V4L2_CAPTURE=y
BR2_PACKAGE_RKMEDIA_RKRGA=y
BR2_PACKAGE_DRM_DISPLAY_OUTPUT=y
BR2_PACKAGE_RKMEDIA_MOVE_DETECTION=y
BR2_PACKAGE_RKMEDIA_ANR=y
BR2_PACKAGE_RKMEDIA_AEC=y
# BR2_PACKAGE_MINIGUI_SOFTWARE_SCALE is not set
BR2_PACKAGE_MEDIASERVER=y
# BR2_PACKAGE_MEDIASERVE_BIN is not set
# BR2_PACKAGE_MEDIASERVE_DBUS is not set
# BR2_PACKAGE_MEDIASERVE_MINILOGGER is not set
BR2_PACKAGE_MEDIASERVE_OSD_SERVER=y
BR2_PACKAGE_CAMERA_ENGINE_RKAIQ=y
BR2_PACKAGE_CAMERA_ENGINE_RKAIQ_IQFILE="os04a10_CMK-OT1607-FV1_M12-4IR-4MP-F16.xml"
# BR2_PACKAGE_ALSA_UTILS_ALSAMIXER is not set
BR2_PACKAGE_FFMPEG=y
# BR2_PACKAGE_FFMPEG_FFMPEG is not set
BR2_PACKAGE_FFMPEG_ENCODERS="aac adpcm_g726 pcm_alaw pcm_mulaw"
BR2_PACKAGE_FFMPEG_DECODERS=""
BR2_PACKAGE_FFMPEG_MUXERS=""
BR2_PACKAGE_FFMPEG_DEMUXERS=""
BR2_PACKAGE_FFMPEG_PARSERS=""
BR2_PACKAGE_FFMPEG_BSFS=""
BR2_PACKAGE_FFMPEG_PROTOCOLS=""
BR2_PACKAGE_FFMPEG_FILTERS=""
# BR2_PACKAGE_FFMPEG_INDEVS is not set
# BR2_PACKAGE_FFMPEG_OUTDEVS is not set
# BR2_PACKAGE_ALSA_LIB_ALOAD is not set
# BR2_PACKAGE_ALSA_LIB_SEQ is not set
# BR2_PACKAGE_ALSA_LIB_ALISP is not set
# BR2_PACKAGE_ALSA_LIB_OLD_SYMBOLS is not set
BR2_PACKAGE_LIBV4L=y
# BR2_PACKAGE_IFUPDOWN_SCRIPTS is not set
```

## configs/rockchip_rv1126_rv1109_recovery_defconfig
```kconfig
#include "base.config"
#include "base_extra.config"
#include "rv1126_rv1109_arm.config"
#include "recovery.config"
BR2_TOOLCHAIN_EXTERNAL_PATH="$(TOPDIR)/../prebuilts/gcc/linux-x86/arm/gcc-arm-8.3-2019.03-x86_64-arm-linux-gnueabihf"
BR2_TOOLCHAIN_EXTERNAL_CUSTOM_PREFIX="arm-linux-gnueabihf"
BR2_TOOLCHAIN_EXTERNAL_GCC_8=y
BR2_TOOLCHAIN_EXTERNAL_HEADERS_4_19=y
BR2_ROOTFS_OVERLAY="board/rockchip/rv1126_rv1109/fs-overlay-recovery/"
```

## configs/rockchip_rv1126_rv1109_sl_defconfig
```kconfig
#include "base.config"
#include "base_extra.config"
#include "debug.config"
#include "video_mpp.config"
#include "rv1126_rv1109_arm.config"
BR2_ROOTFS_OVERLAY="board/rockchip/rv1126_rv1109/fs-overlay-sl/"
BR2_PACKAGE_GDB=y
BR2_PACKAGE_GDB_DEBUGGER=y
BR2_PACKAGE_RKNPU=y
BR2_PACKAGE_RKNPU_USE_MINI_DRIVER=y
BR2_PACKAGE_CAMERA_ENGINE_RKAIQ=y
BR2_PACKAGE_CAMERA_ENGINE_RKAIQ_IQFILE="os04a10_CMK-OT1607-FV1_M12-4IR-4MP-F16.xml"
BR2_PACKAGE_DBUS_GLIB=y
BR2_PACKAGE_LIBV4L=y
BR2_PACKAGE_LIBV4L_UTILS=y
BR2_PACKAGE_UVC_APP=y
BR2_PACKAGE_RKNPU_NOT_RUN_RKNN_SERVER=y
BR2_PACKAGE_ROCKCHIP_UTILS=y
BR2_PACKAGE_RKSL=y
```

## configs/rockchip_rv1126_rv1109_spi_nand_recovery_defconfig
```kconfig
#include "base.config"
#include "base_extra.config"
#include "rv1126_rv1109_arm.config"
#include "recovery.config"
#include "ubifs.config"
BR2_ROOTFS_OVERLAY="board/rockchip/rv1126_rv1109/fs-overlay-nand-recovery/"
BR2_PACKAGE_RECOVERY_NO_UI=y
BR2_PACKAGE_RECOVERY_USE_UPDATEENGINE=y
BR2_PACKAGE_RECOVERY_RECOVERYBIN=y
BR2_PACKAGE_RECOVERY_UPDATEENGINEBIN=y
```

## configs/rockchip_rv1126_rv1109_tb_defconfig
```kconfig
#include "base.config"
#include "base_extra.config"
#include "debug.config"
#include "audio.config"
#include "wifi.config"
#include "network.config"
#include "video_mpp.config"
#include "rv1126_rv1109_arm.config"
BR2_ROOTFS_OVERLAY="board/rockchip/rv1126_rv1109/fs-overlay-sysv/"
BR2_PACKAGE_RKWIFIBT_AP6256=y
BR2_PACKAGE_RKWIFIBT_BTUART="ttyS0"
BR2_PACKAGE_FFMPEG=y
BR2_PACKAGE_FFMPEG_ENCODERS="mp2 adpcm_g726 pcm_alaw pcm_mulaw rawvideo mjpeg mpeg2video"
BR2_PACKAGE_FFMPEG_DECODERS="pcm_alaw pcm_mulaw rawvideo mjpeg mpeg2video"
BR2_PACKAGE_FFMPEG_MUXERS="pcm_alaw pcm_mulaw g722 g726 adts rawvideo mjpeg mp4 mov rtp flv f4v mpegts matroska avi rtsp mpeg1system"
BR2_PACKAGE_FFMPEG_DEMUXERS="pcm_alaw pcm_mulaw g722 g726 rawvideo mpegts mov flv matroska avi"
BR2_PACKAGE_FFMPEG_PARSERS=""
BR2_PACKAGE_FFMPEG_BSFS="aac_adtstoasc h264_metadata h264_mp4toannexb h264_redundant_pps hevc_metadata hevc_mp4toannexb dump_extradata remove_extradata"
BR2_PACKAGE_FFMPEG_PROTOCOLS="file rtp srtp rtmp rtmps http https"
BR2_PACKAGE_FFMPEG_FILTERS="scale"
BR2_PACKAGE_EXIV2=y
BR2_PACKAGE_FREETYPE=y
BR2_PACKAGE_LIBV4L=y
BR2_PACKAGE_LIBV4L_UTILS=y
BR2_PACKAGE_LIVE555=y
BR2_PACKAGE_LIBPTHREAD_STUBS=y
BR2_PACKAGE_LIBUNWIND=y
BR2_PACKAGE_CONNMAN=y
BR2_PACKAGE_CONNMAN_WIFI=y
BR2_PACKAGE_CONNMAN_LOOPBACK=y
BR2_PACKAGE_CONNMAN_CLIENT=y
```
