## configs/rockchip_rv1126_rv1109_tinyrootfs_defconfig
```kconfig
#include "tinyrootfs.config"
#include "arm_a7.config"
#include "gcc8.config"
BR2_TARGET_GENERIC_HOSTNAME="RV1126_RV1109"
BR2_TARGET_GENERIC_ISSUE="Welcome to RV1126/RV1109 thunder boot rootfs"
BR2_TARGET_GENERIC_ROOT_PASSWD="rockchip"
BR2_TARGET_GENERIC_GETTY_PORT="ttyFIQ0"
BR2_TARGET_GENERIC_GETTY_BAUDRATE_1500000=y
BR2_ROOTFS_OVERLAY="board/rockchip/rv1126_rv1109/fs-overlay-tinyrootfs"
BR2_ROOTFS_POST_BUILD_SCRIPT="board/rockchip/common/tinyrootfs/post-build-tinyrootfs.sh"
BR2_PACKAGE_RV1126_RV1109=y
BR2_PACKAGE_MPP_ALLOCATOR_DRM=y
BR2_PACKAGE_RKMEDIA_MPP=y
BR2_PACKAGE_RKMEDIA_V4L2_CAPTURE=y
# BR2_PACKAGE_RKMEDIA_RKGUARD is not set
BR2_PACKAGE_RKMEDIA_RKRGA=y
BR2_PACKAGE_RKMEDIA_RKNN=y
BR2_PACKAGE_RKMEDIA_ROCKFACE=y
BR2_PACKAGE_DRM_DISPLAY_OUTPUT=y
BR2_PACKAGE_RKMEDIA_LIVE555=y
BR2_PACKAGE_RKMEDIA_RTSP_SERVER=y
BR2_PACKAGE_RKMEDIA_RTSP_SERVER_H264=y
BR2_PACKAGE_RKMEDIA_EXAMPLES=y
# BR2_PACKAGE_MINIGUI_SOFTWARE_SCALE is not set
BR2_PACKAGE_RKNPU_USE_MINI_DRIVER=y
# BR2_PACKAGE_ROCKFACE_FACE_RECOGNITION is not set
# BR2_PACKAGE_ROCKFACE_FACE_LANDMARK is not set
# BR2_PACKAGE_ROCKFACE_FACE_ATTRIBUTE is not set
# BR2_PACKAGE_ROCKFACE_OBJECT_DETECTION is not set
BR2_PACKAGE_MEDIASERVER=y
BR2_PACKAGE_MEDIASERVE_CONIFG="tb_rtsp-link.conf"
# BR2_PACKAGE_MEDIASERVE_DBUS is not set
# BR2_PACKAGE_MEDIASERVE_MINILOGGER is not set
BR2_PACKAGE_CAMERA_ENGINE_RKAIQ=y
BR2_PACKAGE_CAMERA_ENGINE_RKAIQ_IQFILE="os04a10_CMK-OT1607-FV1_M12-40IRC-4MP-F16.xml"
BR2_PACKAGE_CAMERA_ENGINE_RKAIQ_IQFILE_USE_BIN=y
BR2_PACKAGE_ISP2_IPC=y
BR2_PACKAGE_LIBV4L=y
BR2_PACKAGE_LIBV4L_UTILS=y
BR2_PACKAGE_EXPAT=y
BR2_PACKAGE_JSON_C=y
BR2_PACKAGE_LIBGLIB2=y
BR2_PACKAGE_DROPBEAR=y
BR2_PACKAGE_GESFTPSERVER=y
# BR2_PACKAGE_IFUPDOWN_SCRIPTS is not set
BR2_PACKAGE_WPA_SUPPLICANT=y
BR2_PACKAGE_WPA_SUPPLICANT_AP_SUPPORT=y
BR2_PACKAGE_WPA_SUPPLICANT_AUTOSCAN=y
BR2_PACKAGE_WPA_SUPPLICANT_EAP=y
BR2_PACKAGE_WPA_SUPPLICANT_CLI=y
BR2_PACKAGE_WPA_SUPPLICANT_WPA_CLIENT_SO=y
BR2_PACKAGE_WPA_SUPPLICANT_PASSPHRASE=y
```

## configs/rockchip_rv1126_rv1109_uvcc_defconfig
```kconfig
#include "base.config"
#include "base_extra.config"
#include "debug.config"
#include "network.config"
#include "video_mpp.config"
#include "rv1126_rv1109_arm.config"
BR2_TARGET_TZ_INFO=y
BR2_ROOTFS_OVERLAY="board/rockchip/rv1126_rv1109/fs-overlay-sysv/"
#BR2_PACKAGE_GDB=y
#BR2_PACKAGE_GDB_DEBUGGER=y
BR2_PACKAGE_RKMEDIA_MPP=y
BR2_PACKAGE_RKMEDIA_V4L2_CAPTURE=y
BR2_PACKAGE_RKMEDIA_RKRGA=y
BR2_PACKAGE_MEDIASERVE_SHM_SERVER=y
BR2_PACKAGE_RKMEDIA_ROCKX=y
BR2_PACKAGE_RKNPU_USE_MINI_DRIVER=y
BR2_PACKAGE_SHM_TOOLS=y
BR2_PACKAGE_LIBIPCPROTOCOL=y
BR2_PACKAGE_MEDIASERVER=y
BR2_PACKAGE_RK_OEM=y
BR2_PACKAGE_RK_OEM_RESOURCE_DIR="$(TOPDIR)/../device/rockchip/oem/oem_uvcc"
BR2_PACKAGE_CAMERA_ENGINE_RKAIQ=y
BR2_PACKAGE_CAMERA_ENGINE_RKAIQ_IQFILE="gc4c33_PCORW0009A_4mm-4M.xml"
BR2_PACKAGE_DBUS_GLIB=y
BR2_PACKAGE_LIBV4L=y
BR2_PACKAGE_LIBV4L_UTILS=y
BR2_PACKAGE_UVC_APP=y
BR2_PACKAGE_RKNPU_NOT_RUN_RKNN_SERVER=y
BR2_PACKAGE_SMART_DISPLAY_SERVICE=y
BR2_PACKAGE_ROCKX=y
BR2_PACKAGE_CONNMAN=y
BR2_PACKAGE_CONNMAN_LOOPBACK=y
BR2_PACKAGE_CONNMAN_CLIENT=y
BR2_PACKAGE_CALLFUNIPC=y
BR2_PACKAGE_ISP2_IPC=y
```

## package/abootimg/Config.in
```kconfig
config BR2_PACKAGE_ABOOTIMG
	bool "abootimg"
	help
	  abootimg - manipulate Android Boot Images.

	  https://github.com/ggrandou/abootimg
```

## package/chromium-wayland/Config.in
```kconfig
config BR2_PACKAGE_CHROMIUM_WAYLAND
	bool "chromium-ozone-wayland"
	depends on (BR2_arm && BR2_GCC_TARGET_FLOAT_ABI = "hard") || BR2_aarch64
	depends on BR2_PACKAGE_WAYLAND
	depends on BR2_TOOLCHAIN_GCC_AT_LEAST_9
	select BR2_PACKAGE_DBUS
	select BR2_PACKAGE_FFMPEG
	select BR2_PACKAGE_FLAC
	select BR2_PACKAGE_LIBERATION
	select BR2_PACKAGE_LIBGLIB2
	select BR2_PACKAGE_LIBNSS
	select BR2_PACKAGE_LIBXSLT
	select BR2_PACKAGE_LIBVPX
	select BR2_PACKAGE_OPUS
	select BR2_PACKAGE_WEBP
	select BR2_PACKAGE_WEBP_DEMUX
	select BR2_PACKAGE_WEBP_MUX
	select BR2_PACKAGE_AT_SPI2_ATK
	help
	  Chromium browser for wayland

	  Prebuilt from yocto's chromium-ozone-wayland:
	  https://github.com/JeffyCN/meta-rockchip/blob/master/dynamic-layers/recipes-browser/chromium/chromium-ozone-wayland_%25.bbappend
```

## package/embedthis/appweb/Config.in
```kconfig
config BR2_PACKAGE_APPWEB
	bool "appweb"
	select BR2_PACKAGE_HOST_MAKEME
	default n
	help
		"Appweb Community Edition Embedded Web Server https://www.embedthis.com/"
```

## package/embedthis/makeme/Config.in.host
```kconfig
config BR2_PACKAGE_HOST_MAKEME
	bool "host makeme"
	help
		"Embedthis MakeMe https://embedthis.com/makeme"
```

## package/firefly/Config.in
```kconfig
source "package/firefly/arcface/Config.in"
source "package/firefly/arcuvc/Config.in"
```

## package/firefly/arcface/Config.in
```kconfig
config BR2_PACKAGE_ARCFACE
    bool "Arc Face App"
    help
        Provided by ArcSoft
```

## package/firefly/arcuvc/Config.in
```kconfig
config BR2_PACKAGE_ARCUVC
    bool "Arc UVC App"
    help
        Provided by ArcSoft
```

## package/intel-wds/Config.in
```kconfig
config BR2_PACKAGE_INTEL_WDS
	bool "intel-wds"
    select BR2_PACKAGE_LIBGLIB2
	select BR2_PACKAGE_GSTREAMER1
	help
	  Wireless Display Software For Linux OS (WDS).

	  https://github.com/intel/wds
```

## package/retroarch/Config.in
```kconfig
config BR2_PACKAGE_RETROARCH
	bool "retroarch"
	help
	  Cross-platform, sophisticated frontend for the libretro API.

	  http://www.libretro.com

if BR2_PACKAGE_RETROARCH

config BR2_PACKAGE_RETROARCH_HID
	bool "retroarch hid"
	default y
	select BR2_PACKAGE_LIBUSB
	help
	  Support hid inputs.

endif
```

## package/rockchip/CallFunIpc/Config.in
```kconfig
config BR2_PACKAGE_CALLFUNIPC
	bool "CallFunIpc"
	select BR2_PACKAGE_LIBGDBUS
	select BR2_PACKAGE_LIBRKDB
	help
	  rockchip CallFunIpc

config BR2_PACKAGE_CALLFUNIPC_DEMO
	bool "CallFunIpc demo"
	depends on BR2_PACKAGE_CALLFUNIPC
```

## package/rockchip/Config.in
```kconfig
menuconfig BR2_PACKAGE_ROCKCHIP
	bool "rockchip BSP packages"

if BR2_PACKAGE_ROCKCHIP
choice
	default BR2_PACKAGE_RV1108
	prompt "rockchip chip support"

config BR2_PACKAGE_RV1108
	bool "rv1108 chip"
	help
		Use rockchip's rv1108 chip

config BR2_PACKAGE_RK312X
	bool "rk312X chip"
	help
		Use rockchip's rk312x chip

config BR2_PACKAGE_RK3036_ECHO
	bool "rk3036G chip"
	help
		Use rockchip's rk3036g chip

config BR2_PACKAGE_RK3308
    bool "rk3308 chip"
    help
        Use rockchip's rk3308 chip

config BR2_PACKAGE_RK3326
    bool "rk3326 chip"
    help
        Use rockchip's rk3326 chip

endchoice

# BSP packages
source "package/rockchip/rv1108-firmware/Config.in"

# Shared packages with all chips
source "package/rockchip/liblog/Config.in"
source "package/rockchip/LocalPlayer/Config.in"
source "package/rockchip/alexaClientSDK/Config.in"
source "package/rockchip/DuerClientSDK/Config.in"
source "package/rockchip/libcutils/Config.in"
source "package/rockchip/libion/Config.in"
source "package/rockchip/mpp/Config.in"
source "package/rockchip/adbd/Config.in"
source "package/rockchip/gstreamer1-rockchip/Config.in"
source "package/rockchip/wakeWordAgent/Config.in"
source "package/rockchip/pcba/Config.in"
source "package/rockchip/libiep/Config.in"
source "package/rockchip/softap/Config.in"
source "package/rockchip/softapServer/Config.in"
source "package/rockchip/wifiAutoSetup/Config.in"
source "package/rockchip/gstreamer1-iep/Config.in"
source "package/rockchip/gst1-libav-rk/Config.in"
source "package/rockchip/rkwifibt/Config.in"
source "package/rockchip/rockchip_utils/Config.in"
source "package/rockchip/mdev_mount/Config.in"
source "package/rockchip/alsa_capture/Config.in"
source "package/rockchip/rockchip_test/Config.in"
source "package/rockchip/rockchip_modules/Config.in"
source "package/rockchip/cypress_bsa/Config.in"
source "package/rockchip/pm-suspend-api/Config.in"
endif
```

## package/rockchip/DuerClientSDK/Config.in
```kconfig
config BR2_PACKAGE_DUERCLIENTSDK
	bool "duer client sdk"
	select BR2_PACKAGE_SQLITE
	select BR2_PACKAGE_RAPIDJSON
```

## package/rockchip/QFacialGate/Config.in
```kconfig
config BR2_PACKAGE_QFACIALGATE
	bool "QFacialGate"
	select BR2_PACKAGE_RKFACIAL
	select BR2_PACKAGE_QT5
	help
	  Rockchip QFacialGate application based on QT
```

## package/rockchip/actionlib-msgs/Config.in
```kconfig
config BR2_PACKAGE_ACTIONLIB_MSGS
	bool "actionlib-msgs for ros"
	select BR2_PACKAGE_HOST_CATKIN
	select BR2_PACKAGE_CPP_COMMON
	select BR2_PACKAGE_ROSCPP_SERIALIZATION
	select BR2_PACKAGE_MESSAGE_GENERATION
	select BR2_PACKAGE_MESSAGE_RUNTIME
	select BR2_PACKAGE_STD_MSGS
	help
		actionlib_msgs defines the common messages to interact with an action server and an action client. For full documentation of the actionlib API see the actionlib package.
```

## package/rockchip/actionlib/Config.in
```kconfig
config BR2_PACKAGE_ACTIONLIB
	bool "actionlib for ros"
	select BR2_PACKAGE_HOST_CATKIN
	select BR2_PACKAGE_ACTIONLIB_MSGS
	select BR2_PACKAGE_MESSAGE_GENERATION
	select BR2_PACKAGE_ROSCPP
	select BR2_PACKAGE_ROSUNIT
	select BR2_PACKAGE_STD_MSGS
	select BR2_PACKAGE_BOOST_THREAD
	select BR2_PACKAGE_BOOST_CHRONO
	select BR2_PACKAGE_BOOST_FILESYSTEM
	select BR2_PACKAGE_BOOST_SIGNALS
	help
		The actionlib package provides a standardized interface for interfacing with preemptible tasks. Examples of this include moving the base to a target location, performing a laser scan and returning the resulting point cloud, detecting the handle of a door, etc.

config BR2_PACKAGE_ACTIONLIB_ENABLE_TEST
	bool "actionlib test for ros"
	select BR2_PACKAGE_ROSTEST
	help
		enalbe actionlib test
```

## package/rockchip/app_demo/Config.in
```kconfig
menuconfig BR2_PACKAGE_APP_DEMO
	bool "rk demos"

if BR2_PACKAGE_APP_DEMO

config BR2_PACKAGE_APP_DEMO_IMAGE_PROCESS
	bool "rk image process demo"
	select BR2_PACKAGE_GFLAGS
	select BR2_PACKAGE_LIBDRM
	select BR2_PACKAGE_LINUX_RGA
	select BR2_PACKAGE_FFMPEG
	select BR2_PACKAGE_FFMPEG_SWSCALE
	select BR2_PACKAGE_SDL2
	select BR2_PACKAGE_SDL2_KMSDRM
	select BR2_PACKAGE_SDL2_OPENGLES
	select BR2_PACKAGE_SDL2_GFX
	select BR2_PACKAGE_SDL2_TTF

endif
```

## package/rockchip/cae_vad/Config.in
```kconfig
config BR2_PACKAGE_RECOVERY
	bool "Cae app using VAD"
	select BR2_PACKAGE_LIBPTHREAD_STUBS
	select BR2_PACKAGE_ALSA_LIB
	help
	  Cae app using VAD.
```

## package/rockchip/camera_engine_rkaiq/Config.in
```kconfig
menuconfig BR2_PACKAGE_CAMERA_ENGINE_RKAIQ
	bool "Rockchip Camera Engine Rkaiq for linux"
	help
	  Rockchip camera engine rkaiq for linux.

if BR2_PACKAGE_CAMERA_ENGINE_RKAIQ

config BR2_PACKAGE_CAMERA_ENGINE_RKAIQ_IQFILE
	string "Rockchip Camera Engine IQ xml file"
	default ""
	help
	  Rockchip sensor IQ xml file.

config BR2_PACKAGE_CAMERA_ENGINE_RKAIQ_IQFILE_USE_BIN
	bool "Rockchip Camera Engine IQ xml file conver to bin"
	default n
	help
	  Rockchip sensor IQ bin file.

config BR2_PACKAGE_CAMERA_ENGINE_RKAIQ_RKISP_DEMO
	bool "Build rkisp_demo"
	default n
	help
		Build rkisp_demo

endif
```

## package/rockchip/camera_engine_rkisp/Config.in
```kconfig
config BR2_PACKAGE_CAMERA_ENGINE_RKISP
	bool "Rockchip Camera Engine for linux"
	help
	  Rockchip camera engine for linux.

config BR2_PACKAGE_CAMERA_ENGINE_RKISP_IQFILE
	depends on BR2_PACKAGE_CAMERA_ENGINE_RKISP
	string "Rockchip Camera Engine IQ xml file"
	default ""
	help
	  Rockchip camera engine for linux.
```

## package/rockchip/catkin/Config.in
```kconfig
config BR2_PACKAGE_CATKIN
	bool "catkin for ROS"
	help
	  Willow Garage low-level build system macros and infrastructure
```

## package/rockchip/catkin/Config.in.host
```kconfig
config BR2_PACKAGE_HOST_CATKIN
	bool "catkin host tool for ROS"
	select BR2_PACKAGE_HOST_PYTHON_CATKIN_PKG
	help
		A CMake-based build system that is used to build all packages in ROS
```
